# 1 "arch/arm64/boot/dts/exynos7580-j7e3g_rev00.dts"
# 1 "<built-in>"
# 1 "<command-line>"
# 1 "arch/arm64/boot/dts/exynos7580-j7e3g_rev00.dts"
# 12 "arch/arm64/boot/dts/exynos7580-j7e3g_rev00.dts"
/dts-v1/;
# 1 "arch/arm64/boot/dts/exynos7580-reserve-1500MB.dtsi" 1
# 12 "arch/arm64/boot/dts/exynos7580-reserve-1500MB.dtsi"
/memreserve/ 0x9F700000 0x900000;
/memreserve/ 0x90000000 0x5c00000;

/ {
 memory@40000000 {
  device_type = "memory";
  reg = <0x0 0x40000000 0x0 0x60000000>;
 };

 reserved-memory {
  #address-cells = <2>;
  #size-cells = <2>;
  ranges;

  fimc_is_fd_reserved: fimc_is_fd {
   compatible = "fd-lib-shmem";
   reg = <0x0 0x9f600000 0x0 0x100000>;
  };

  common {
   compatible = "exynos5433-ion,common";
   reg = <0x0 0x9f000000 0x0 0x600000>;
   id = <0>;
  };

  video {
   compatible = "exynos5433-ion,video";
   secure;
   reusable;
   reg = <0x0 0x9c000000 0x0 0x3000000>;
   id = <11>;
   compat-id = <4 5 6 7>;
  };

  video_ext {
   compatible = "exynos5433-ion,video_ext";
   secure;
   reusable;
   reg = <0x0 0x99000000 0x0 0x1400000>;
   id = <1>;
  };

  video_ext2 {
   compatible = "exynos5433-ion,video_ext2";
   secure;
   reusable;
   reg = <0x0 0x9a400000 0x0 0x1800000>;
   id = <3>;
  };

  mfc_nfw {
   compatible = "exynos5433-ion,mfc_nfw";
   reg = <0x0 0x9be00000 0x0 0x110000>;
   id = <12>;
  };

  mfc_fw {
   compatible = "exynos5433-ion,mfc_fw";
   secure;
   reg = <0x0 0x9bc00000 0x0 0x200000>;
   id = <8>;
  };

  secdma {
   compatible = "exynos5433-ion,secdma";
   size = <0 0x20000>;
   alignment = <0 0x10000>;
   id = <13>;
  };
 };
};
# 14 "arch/arm64/boot/dts/exynos7580-j7e3g_rev00.dts" 2
# 1 "arch/arm64/boot/dts/exynos7580.dtsi" 1
# 16 "arch/arm64/boot/dts/exynos7580.dtsi"
# 1 "/home/dpi/qb5_8814/workspace/J7E3G_EUR_OPEN/android/kernel/exynos7580/include/dt-bindings/clock/exynos7580.h" 1
# 17 "arch/arm64/boot/dts/exynos7580.dtsi" 2
# 1 "/home/dpi/qb5_8814/workspace/J7E3G_EUR_OPEN/android/kernel/exynos7580/include/dt-bindings/sysmmu/sysmmu.h" 1
# 18 "arch/arm64/boot/dts/exynos7580.dtsi" 2
/include/ "exynos7580-pinctrl.dtsi"
/include/ "exynos7580-noc.dtsi"

/ {
 model = "Samsung Exynos7580";
 compatible = "samsung,exynos7580";
 interrupt-parent = <&gic>;
 #address-cells = <2>;
 #size-cells = <2>;

 aliases {
  decon0 = &decon_0;
  dsim0 = &dsim_0;
  hsi2c0 = &hsi2c_0;
  hsi2c1 = &hsi2c_1;
  hsi2c2 = &hsi2c_2;
  hsi2c3 = &hsi2c_3;
  mdev0 = &mdev_0;
  mfc0 = &mfc_0;
  mshc0 = &dwmmc_0;
  mshc1 = &dwmmc_1;
  mshc2 = &dwmmc_2;
  pinctrl0 = &pinctrl_0;
  pinctrl1 = &pinctrl_1;
  pinctrl2 = &pinctrl_2;
  pinctrl3 = &pinctrl_3;
  pinctrl4 = &pinctrl_4;
  pinctrl5 = &pinctrl_5;
  pinctrl6 = &pinctrl_6;
  pinctrl7 = &pinctrl_7;
  scaler0 = &scaler_0;
  scaler1 = &scaler_1;
  uart0 = &serial_0;
  uart1 = &serial_1;
  uart2 = &serial_2;
  uart3 = &serial_3;
  tmuctrl0 = &tmuctrl_0;
  tmuctrl1 = &tmuctrl_1;
  jpeg0 = &jpeg_0;
  tmuctrl2 = &tmuctrl_2;
  spi0 = &spi_0;
  spi1 = &spi_1;
  spi2 = &spi_2;
 };

 cpus {
  #address-cells = <2>;
  #size-cells = <0>;

  cpu@000 {
   device_type = "cpu";
   compatible = "arm,cortex-a53", "arm,armv8";
   reg = <0x0 0x000>;
   enable-method = "psci";
   cpu-idle-states = <&CPU_SLEEP_0 &CPU_SLEEP_1 &CPU_SLEEP_2 &CPU_SLEEP_3>;
   operating-points = <

    1600000 1300000
    1500000 1287500
    1400000 1237500
    1300000 1187500
    1200000 1150000
    1100000 1112500
    1000000 1075000
     900000 1037500
     800000 1000000
     700000 962500
     600000 925000
     500000 887500
     400000 850000
     300000 850000
    >;
   clocks = <&clock 16>;
   clock-names = "cpu-cluster.0";
   voltage-tolerance = <1>;
   clock-latency = <100000>;
  };
  cpu@001 {
   device_type = "cpu";
   compatible = "arm,cortex-a53", "arm,armv8";
   reg = <0x0 0x001>;
   enable-method = "psci";
   cpu-idle-states = <&CPU_SLEEP_0 &CPU_SLEEP_1 &CPU_SLEEP_2 &CPU_SLEEP_3>;
  };
  cpu@002 {
   device_type = "cpu";
   compatible = "arm,cortex-a53", "arm,armv8";
   reg = <0x0 0x002>;
   enable-method = "psci";
   cpu-idle-states = <&CPU_SLEEP_0 &CPU_SLEEP_1 &CPU_SLEEP_2 &CPU_SLEEP_3>;
  };
  cpu@003 {
   device_type = "cpu";
   compatible = "arm,cortex-a53", "arm,armv8";
   reg = <0x0 0x003>;
   enable-method = "psci";
   cpu-idle-states = <&CPU_SLEEP_0 &CPU_SLEEP_1 &CPU_SLEEP_2 &CPU_SLEEP_3>;
  };
  cpu@100 {
   device_type = "cpu";
   compatible = "arm,cortex-a53", "arm,armv8";
   reg = <0x0 0x100>;
   enable-method = "psci";
   cpu-idle-states = <&CPU_SLEEP_0 &CPU_SLEEP_1 &CPU_SLEEP_2 &CPU_SLEEP_3>;
   operating-points = <

    1600000 1300000
    1500000 1287500
    1400000 1237500
    1300000 1187500
    1200000 1150000
    1100000 1112500
    1000000 1075000
     900000 1037500
     800000 1000000
     700000 962500
     600000 925000
     500000 887500
     400000 850000
     300000 850000
    >;
   clocks = <&clock 17>;
   clock-names = "cpu-cluster.1";
   voltage-tolerance = <1>;
   clock-latency = <100000>;
  };
  cpu@101 {
   device_type = "cpu";
   compatible = "arm,cortex-a53", "arm,armv8";
   reg = <0x0 0x101>;
   enable-method = "psci";
   cpu-idle-states = <&CPU_SLEEP_0 &CPU_SLEEP_1 &CPU_SLEEP_2 &CPU_SLEEP_3>;
  };
  cpu@102 {
   device_type = "cpu";
   compatible = "arm,cortex-a53", "arm,armv8";
   reg = <0x0 0x102>;
   enable-method = "psci";
   cpu-idle-states = <&CPU_SLEEP_0 &CPU_SLEEP_1 &CPU_SLEEP_2 &CPU_SLEEP_3>;
  };
  cpu@103 {
   device_type = "cpu";
   compatible = "arm,cortex-a53", "arm,armv8";
   reg = <0x0 0x103>;
   enable-method = "psci";
   cpu-idle-states = <&CPU_SLEEP_0 &CPU_SLEEP_1 &CPU_SLEEP_2 &CPU_SLEEP_3>;
  };

  idle-states {
   entry-method = "arm,psci";

   CPU_SLEEP_0: C1 {
    compatible = "arm,idle-state";
    desc = "ARM clock gating (WFI)";
    entry-method-param = <0x0000000>;
    exit-latency-us = <10>;
    min-residency-us = <500>;
    status = "enabled";
   };

   CPU_SLEEP_1: C2 {
    compatible = "arm,idle-state";
    desc = "ARM power down";
    entry-method-param = <0x0000000>;
    exit-latency-us = <100>;
    min-residency-us = <750>;
    status = "enabled";
   };

   CPU_SLEEP_2: CPD {
    compatible = "arm,idle-state";
    desc = "Cluster power down";
    entry-method-param = <0x1000000>;
    exit-latency-us = <300>;
    min-residency-us = <3000>;
    status = "enabled";
   };

   CPU_SLEEP_3: LPM {
    compatible = "arm,idle-state";
    desc = "System power down";
    entry-method-param = <0x1000000>;
    exit-latency-us = <300>;
    min-residency-us = <5000>;
    status = "enabled";
   };
  };
 };

 trace@16000000 {
  compatible = "trace";
  reg = <0x0 0x16000000 0x0 0xc00000>;
  #address-cells = <1>;
  #size-cells = <1>;

  coresight@16000000 {
   compatible = "exynos,coresight";
   reg = <0x16000000 0xc00000>;
   #address-cells = <1>;
   #size-cells = <0>;
   css_pc@0 {
    device_type = "cs";
    offset = <0x410000>;
   };
   css_pc@1 {
    device_type = "cs";
    offset = <0x510000>;
   };
   css_pc@2 {
    device_type = "cs";
    offset = <0x610000>;
   };
   css_pc@3 {
    device_type = "cs";
    offset = <0x710000>;
   };
   css_pc@4 {
    device_type = "cs";
    offset = <0x810000>;
   };
   css_pc@5 {
    device_type = "cs";
    offset = <0x910000>;
   };
   css_pc@6 {
    device_type = "cs";
    offset = <0xa10000>;
   };
   css_pc@7 {
    device_type = "cs";
    offset = <0xb10000>;
   };
   etm_core@0 {
    device_type = "etm";
    offset = <0x440000>;
    funnel_port = <0x0>;
   };
   etm_core@1 {
    device_type = "etm";
    offset = <0x540000>;
    funnel_port = <0x1>;
   };
   etm_core@2 {
    device_type = "etm";
    offset = <0x640000>;
    funnel_port = <0x2>;
   };
   etm_core@3 {
    device_type = "etm";
    offset = <0x740000>;
    funnel_port = <0x3>;
   };
   etm_core@4 {
    device_type = "etm";
    offset = <0x840000>;
    funnel_port = <0x4>;
   };
   etm_core@5 {
    device_type = "etm";
    offset = <0x940000>;
    funnel_port = <0x5>;
   };
   etm_core@6 {
    device_type = "etm";
    offset = <0xa40000>;
    funnel_port = <0x6>;
   };
   etm_core@7 {
    device_type = "etm";
    offset = <0xb40000>;
    funnel_port = <0x7>;
   };
   funnel@0 {
    device_type = "funnel";
    offset = <0x4000>;
   };
   funnel@1 {
    device_type = "funnel";
    offset = <0x9000>;
   };
   etb {
    device_type = "etb";
    offset = <0x1000>;
   };
  };
 };

 stm: stm@16005000 {
  compatible = "arm,coresight-stm";
  reg = <0x0 0x16005000 0x0 0x1000>,
   <0x0 0x109f0000 0x0 0x1000>,
   <0x0 0x109e0000 0x0 0x100>;

  coresight-id = <9>;
  coresight-name = "coresight-stm";
  coresight-nr-inports = <0>;
 };

 gic:interrupt-controller@10C00000 {
  compatible = "arm,cortex-a15-gic";
  #interrupt-cells = <3>;
  interrupt-controller;
  reg = <0x0 0x10C01000 0x0 0x1000>,
   <0x0 0x10C02000 0x0 0x1000>,
   <0x0 0x10C04000 0x0 0x2000>,
   <0x0 0x10C06000 0x0 0x2000>;
  interrupts = <1 9 0xf04>;
 };

 psci {
  compatible = "arm,psci";
  method = "smc";
  cpu_suspend = <0xC4000001>;
  cpu_off = <0x84000002>;
  cpu_on = <0xC4000003>;
 };

 timer {
  compatible = "arm,armv8-timer";
  interrupts = <1 13 0xff01>,
        <1 14 0xff01>,
        <1 11 0xff01>,
        <1 10 0xff01>;
  clock-frequency = <26000000>;
  use-clocksource-only;
  use-physical-timer;
 };

 clock: clock-controller@0x10010000 {
  compatible = "samsung,exynos7580-clock";
  reg = <0x0 0x10010000 0x0 0x1000>;
  #clock-cells = <1>;
 };

 bus_int {
  compatible = "samsung,exynos7-devfreq-int";

  bus_type_int = <0>;
  downdifferential= <20>;

  pm_qos_class = <4>;
  upthreshold = <70>;
  cal_qos_max = <00 400000>;
  default_qos = <00 100000>;
  initial_freq = <00 400000>;
  polling_period = <0>;
 };

 bus_mif {
  compatible = "samsung,exynos7-devfreq-mif";

  bus_type_mif = <1>;
  downthreshold = <60>;

  urgentthreshold = <80>;
  idlethreshold = <50>;

  pm_qos_class = <5>;
  upthreshold = <70>;
  cal_qos_max = <00 825000>;
  default_qos = <00 416000>;
  initial_freq = <00 825000>;
  polling_period = <0>;
 };

 bus_isp {
  compatible = "samsung,exynos7-devfreq-isp";

  pm_qos_class = <13>;
  upthreshold = <95>;
  cal_qos_max = <00 530000>;
  default_qos = <00 200000>;
  initial_freq = <00 200000>;
  polling_period = <0>;
 };

 ppmu {
  compatible = "samsung,exynos7580-ppmu";
  #address-cells = <2>;
  #size-cells = <2>;
  ranges;

  ppmu-int {
   reg = <0x0 0x10480000 0x0 0x00000400>,
         <0x0 0x10490000 0x0 0x00000400>;
  };

  ppmu-mif {
   reg = <0x0 0x10470000 0x0 0x00000400>,
         <0x0 0x10480000 0x0 0x00000400>,
         <0x0 0x10490000 0x0 0x00000400>;
  };

  ppmu-total {
   reg = <0x0 0x10470000 0x0 0x00000400>,
         <0x0 0x10480000 0x0 0x00000400>,
         <0x0 0x10490000 0x0 0x00000400>;
  };
 };

 mct@100B0000 {
  compatible = "samsung,exynos4210-mct";
  reg = <0x0 0x100B0000 0x0 0x800>;
  interrupt-controller;
  #interrupt-cells = <1>;
  interrupt-parent = <&mct_map>;
  interrupts = <0>, <1>, <2>, <3>,
        <4>, <5>, <6>, <7>,
        <8>, <9>, <10>, <11>;
  clocks = <&clock 1>, <&clock 109>;
  clock-names = "fin_pll", "mct";
  use-clockevent-only;
  mct_map: mct-map {
   #interrupt-cells = <1>;
   #address-cells = <0>;
   #size-cells = <0>;
   interrupt-map = <0 &gic 0 102 0>,
     <1 &gic 0 103 0>,
     <2 &gic 0 104 0>,
     <3 &gic 0 105 0>,
     <4 &gic 0 106 0>,
     <5 &gic 0 107 0>,
     <6 &gic 0 108 0>,
     <7 &gic 0 109 0>,
     <8 &gic 0 110 0>,
     <9 &gic 0 111 0>,
     <10 &gic 0 112 0>,
     <11 &gic 0 113 0>;
  };
 };

 lpass: lpass@11000000 {
  compatible = "samsung,exynos7580-lpass";
  reg = <0x0 0x11000000 0x0 0x100>,
        <0x0 0x03000000 0x0 0xa000>;
  clocks = <&clock 140>,
   <&clock 18>,
   <&clock 1>,
   <&clock 141>,
   <&clock 142>,
   <&clock 143>,
   <&clock 144>,
   <&clock 145>,
   <&clock 146>,
   <&clock 149>,
   <&clock 152>;

  clock-names = "dmac",
   "fout_aud_pll", "fin_pll", "mout_aud_pll_user",
   "mout_sclk_mi2s", "mout_sclk_pcm", "sramc",
   "dout_sclk_133", "dout_sclk_mi2s", "audmixer_dout",
   "mi2s_aud_bclk" ;
  samsung,power-domain = <&pd_aud>;
 };

 serial_0: uart@13800000 {
  compatible = "samsung,exynos5430-uart";
  samsung,separate-uart-clk;
  reg = <0x0 0x13800000 0x0 0x100>;
  interrupts = <0 421 0>;
  pinctrl-names = "default";
  pinctrl-0 = <&uart0_bus>;
  clocks = <&clock 103>, <&clock 104>, <&clock 100>;
  clock-names = "gate_pclk0", "gate_uart0", "sclk_uart0";
 };

 serial_1: uart@13810000 {
  compatible = "samsung,exynos5430-uart";
  samsung,separate-uart-clk;
  reg = <0x0 0x13810000 0x0 0x100>;
  interrupts = <0 422 0>;
  pinctrl-names = "default";
  pinctrl-0 = <&uart1_bus>;
  clocks = <&clock 105>, <&clock 106>, <&clock 101>;
  clock-names = "gate_pclk1", "gate_uart1", "sclk_uart1";
 };

 serial_2: uart@13820000 {
  compatible = "samsung,exynos5430-uart";
  samsung,separate-uart-clk;
  reg = <0x0 0x13820000 0x0 0x100>;
  interrupts = <0 423 0>;
  pinctrl-names = "default";
  pinctrl-0 = <&uart2_bus>;
  clocks = <&clock 107>, <&clock 108>, <&clock 102>;
  clock-names = "gate_pclk2", "gate_uart2", "sclk_uart2";
  status = "disabled";
 };

 serial_3: uart@11060000 {
  compatible = "samsung,exynos5430-uart";
  reg = <0x0 0x11060000 0x0 0x100>;
  interrupts = <0 67 0>;
  pinctrl-names = "default", "idle", "lpm";
  pinctrl-0 = <&uart_aud_bus>;
  pinctrl-1 = <&uart_aud_bus_idle>;
  pinctrl-2 = <&uart_aud_bus_lpm>;
  samsung,separate-uart-clk;
  samsung,lpass-subip;
  clocks = <&clock 110>, <&clock 111>, <&clock 148>;
  clock-names = "gate_pclk3", "gate_uart3", "sclk_uart3";
  status = "disabled";
 };

 tmuctrl_0: tmuctrl@10030000 {
  compatible = "samsung,exynos7580-tmu";
  reg = <0x0 0x10030000 0x0 0x200>, <0x0 0x10030000 0x0 0x200>;
  interrupts = <0 435 0>;
 };

 tmuctrl_1: tmuctrl@10060000 {
  compatible = "samsung,exynos7580-tmu";
  reg = <0x0 0x10060000 0x0 0x200>, <0x0 0x10040000 0x0 0x200>;
  interrupts = <0 114 0>;
 };

 scaler_0: scaler@12C00000 {
  compatible = "samsung,exynos5-scaler";
  reg = <0x0 0x12C00000 0x0 0x1300>;
  interrupts = <0 400 0>;
  samsung,power-domain = <&spd_mscl0>;
  #pb-id-cells = <0>;
  clock-names = "gate", "gate2", "mux_user", "mux_src";
  clocks = <&clock ((3500) + 0)>, <&clock ((3500) + 2)>,
  <&clock ((3500) + 5)>, <&clock ((3500) + 4)>;
 };

 scaler_1: scaler@12C10000 {
  compatible = "samsung,exynos5-scaler";
  reg = <0x0 0x12C10000 0x0 0x1300>;
  interrupts = <0 401 0>;
  samsung,power-domain = <&spd_mscl1>;
  #pb-id-cells = <0>;
  clock-names = "gate", "gate2", "mux_user", "mux_src";
  clocks = <&clock ((3500) + 1)>, <&clock ((3500) + 3)>,
  <&clock ((3500) + 5)>, <&clock ((3500) + 4)>;
 };

 tmuctrl_2: tmuctrl@10040000 {
  compatible = "samsung,exynos7580-tmu";
  reg = <0x0 0x10040000 0x0 0x200>, <0x0 0x10060000 0x0 0x200>;
  interrupts = <0 436 0>;
 };

 pinctrl_0: pinctrl@139B0000 {
  compatible = "samsung,exynos7580-pinctrl";
  reg = <0x0 0x139B0000 0x0 0x1000>;
  interrupts = <0 0 0>, <0 1 0>, <0 2 0>, <0 3 0>,
    <0 4 0>, <0 5 0>, <0 6 0>, <0 7 0>,
    <0 8 0>, <0 9 0>, <0 10 0>, <0 11 0>,
    <0 12 0>, <0 13 0>, <0 14 0>, <0 15 0>;
  wakeup-interrupt-controller {
   compatible = "samsung,exynos4210-wakeup-eint";
   interrupt-parent = <&gic>;
   interrupts = <0 16 0>;
   samsung,eint-flt-conf;
  };
 };

 pinctrl_1: pinctrl@110B0000 {
  compatible = "samsung,exynos7580-pinctrl";
  reg = <0x0 0x110B0000 0x0 0x1000>;
  interrupts = <0 68 0>;
 };

 pinctrl_2: pinctrl@138E0000 {
  compatible = "samsung,exynos7580-pinctrl";
  reg = <0x0 0x138E0000 0x0 0x1000>;
  interrupts = <0 438 0>;
 };

 pinctrl_3: pinctrl@13750000 {
  compatible = "samsung,exynos7580-pinctrl";
  reg = <0x0 0x13750000 0x0 0x1000>;
  interrupts = <0 250 0>;
 };

 pinctrl_4: pinctrl@104E0000 {
  compatible = "samsung,exynos7580-pinctrl";
  reg = <0x0 0x104E0000 0x0 0x1000>;
  interrupts = <0 385 0>;
 };

 pinctrl_5: pinctrl@138C0000 {
  compatible = "samsung,exynos7580-pinctrl";
  reg = <0x0 0x138C0000 0x0 0x1000>;
  interrupts = <0 115 0>;
 };

 pinctrl_6: pinctrl@139C0000 {
  compatible = "samsung,exynos7580-pinctrl";
  reg = <0x0 0x139C0000 0x0 0x1000>;
  interrupts = <0 440 0>;
 };

 pinctrl_7: pinctrl@138D0000 {
  compatible = "samsung,exynos7580-pinctrl";
  reg = <0x0 0x138D0000 0x0 0x1000>;
  interrupts = <0 116 0>;
 };

 i2c_0: i2c@13830000 {
  compatible = "samsung,s3c2440-i2c";
  reg = <0x0 0x13830000 0x0 0x100>;
  interrupts = <0 424 0>;
  #address-cells = <1>;
  #size-cells = <0>;
  pinctrl-names = "default";
  pinctrl-0 = <&i2c6_bus>;

  clocks = <&clock 130>, <&clock 130>;
  clock-names = "rate_i2c", "gate_i2c";
  status = "disabled";
 };

 i2c_1: i2c@13840000 {
  compatible = "samsung,s3c2440-i2c";
  reg = <0x0 0x13840000 0x0 0x100>;
  interrupts = <0 425 0>;
  #address-cells = <1>;
  #size-cells = <0>;
  pinctrl-names = "default";
  pinctrl-0 = <&i2c_nfc_bus>;
  clocks = <&clock 131>, <&clock 131>;
  clock-names = "rate_i2c", "gate_i2c";
  status = "disabled";
 };

 i2c_2: i2c@13850000 {
  compatible = "samsung,s3c2440-i2c";
  reg = <0x0 0x13850000 0x0 0x100>;
  interrupts = <0 426 0>;
  #address-cells = <1>;
  #size-cells = <0>;
  pinctrl-names = "default";
  pinctrl-0 = <&i2c_nfc_bus>;
  clocks = <&clock 132>, <&clock 132>;
  clock-names = "rate_i2c", "gate_i2c";
  status = "disabled";
 };

 i2c_3: i2c@13860000 {
  compatible = "samsung,s3c2440-i2c";
  reg = <0x0 0x13860000 0x0 0x100>;
  interrupts = <0 427 0>;
  #address-cells = <1>;
  #size-cells = <0>;
  pinctrl-names = "default";
  pinctrl-0 = <&i2c_touch_bus>;
  clocks = <&clock 133>, <&clock 133>;
  clock-names = "rate_i2c", "gate_i2c";
  status = "disabled";
 };

 hsi2c_0: hsi2c@13870000 {
  compatible = "samsung,exynos5-hsi2c";
  samsung,check-transdone-int;
  reg = <0x0 0x13870000 0x0 0x1000>;
  interrupts = <0 428 0>;
  #address-cells = <1>;
  #size-cells = <0>;
  pinctrl-names = "default";
  pinctrl-0 = <&hs_i2c0_bus>;
  clocks = <&clock 120>, <&clock 120>;
  clock-names = "rate_hsi2c", "gate_hsi2c";
  samsung,scl-clk-stretching;
  gpio_sda = <&gpc2 0 0x1>;
  gpio_scl = <&gpc2 1 0x1>;
  status = "disabled";
 };

 hsi2c_1: hsi2c@13880000 {
  compatible = "samsung,exynos5-hsi2c";
  samsung,check-transdone-int;
  reg = <0x0 0x13880000 0x0 0x1000>;
  interrupts = <0 429 0>;
  #address-cells = <1>;
  #size-cells = <0>;
  pinctrl-names = "default";
  pinctrl-0 = <&hs_i2c1_bus>;
  clocks = <&clock 121>, <&clock 121>;
  clock-names = "rate_hsi2c", "gate_hsi2c";
  samsung,scl-clk-stretching;
  status = "disabled";
 };

 hsi2c_2: hsi2c@13890000 {
  compatible = "samsung,exynos5-hsi2c";
  samsung,check-transdone-int;
  reg = <0x0 0x13890000 0x0 0x1000>;
  interrupts = <0 430 0>;
  #address-cells = <1>;
  #size-cells = <0>;
  pinctrl-names = "default";
  pinctrl-0 = <&hs_i2c2_bus>;
  clocks = <&clock 122>, <&clock 122>;
  clock-names = "rate_hsi2c", "gate_hsi2c";
  samsung,scl-clk-stretching;
  status = "disabled";
 };

 hsi2c_3: hsi2c@104c0000 {
  compatible = "samsung,exynos5-hsi2c";
  samsung,check-transdone-int;
  reg = <0x0 0x104c0000 0x0 0x2000>, <0x0 0x104b0180 0x0 0x100>;
  interrupts = <0 384 0>, <0 394 0>;
  #address-cells = <1>;
  #size-cells = <0>;
  pinctrl-names = "default";
  pinctrl-0 = <&hs_i2c3_bus>;
  clocks = <&clock 123>, <&clock 123>;
  clock-names = "rate_hsi2c", "gate_hsi2c";
  gpio_sda= <&gpm0 0 0x1>;
  gpio_scl= <&gpm0 1 0x1>;

  status = "disabled";
 };

 dwmmc_0: dwmmc0@13540000 {
  compatible = "samsung,exynos7580-dw-mshc";
  reg = <0x0 0x13540000 0x0 0x2000>;
  interrupts = <0 245 0>;
  #address-cells = <1>;
  #size-cells = <0>;
  clocks = <&clock 202>, <&clock 208>, <&clock 211>, <&clock 212>;
  clock-names = "biu", "gate_ciu", "dout_mmc_a", "dout_mmc_b";
  status = "disabled";
 };

 wlan {
                compatible = "samsung,brcm-wlan";
                gpios = <&gpd1 0 0x1
                         &gpa2 3 0x1 >;
                pinctrl-names = "default";
                pinctrl-0 = <&cfg_wlanen &cfg_wlanhostwake>;
                status = "okay";
 };

 secgpio_dvs {
  compatible = "samsung,exynos7580-secgpio-dvs";
  status = "okay";
 };

 sec_thermistor@0 {
  compatible = "samsung,sec-ap-thermistor";
  status = "okay";

  adc_array = <287 296 306 316 326 335 345 355 365 374
              384 409 434 459 484 509 515 521 527 533
       539 555 572 588 605 627 649 672 694 719
       745 766 788 806 824 874 915 956 973 990
       1015 1050 1084 1121 1155 1192 1235 1271 1308 1353
       1399 1435 1471 1507 1543 1579 1627 1676 1724 1773
       1822 1861 1900 1939 1978 2017 2056 2095 2134 2173
       2212 2242 2275 2308 2341 2374 2419 2463 2508 2552
       2597 2629 2661 2694 2726 2758 2790 2823 2855 2883
       2911 2949 2975 3001 3027 3054 3080 3105 3130 3155
       3180 3196 3213 3230 3246 3263 3271 3280 3288 3297 3305>;
  temp_array = <900 890 880 870 860 850 840 830 820 810
        800 790 780 770 760 750 740 730 720 710
        700 690 680 670 660 650 640 630 620 610
        600 590 580 570 560 550 540 530 520 510
        500 490 480 470 460 450 440 430 420 410
        400 390 380 370 360 350 340 330 320 310
        300 290 280 270 260 250 240 230 220 210
        200 190 180 170 160 150 140 130 120 110
        100 90 80 70 60 50 40 30 20 10
        0 (-10) (-20) (-30) (-40) (-50) (-60) (-70) (-80) (-90)
        (-100) (-110) (-120) (-130) (-140) (-150) (-160) (-170) (-180) (-190) (-200)>;
  io-channels = <&exynos_adc 0>;
  io-channel-names = "adc-ap-temp";
  io-channel-ranges;
 };

 dwmmc_1: dwmmc1@13550000 {
  compatible = "samsung,exynos7580-dw-mshc";
  reg = <0x0 0x13550000 0x0 0x2000>;
  interrupts = <0 246 0>;
  #address-cells = <1>;
  #size-cells = <0>;
  clocks = <&clock 203>, <&clock 209>, <&clock 213>, <&clock 214>;
  clock-names = "biu", "gate_ciu", "dout_mmc_a", "dout_mmc_b";
  status = "disabled";
 };

 dwmmc_2: dwmmc2@13560000 {
  compatible = "samsung,exynos7580-dw-mshc";
  reg = <0x0 0x13560000 0x0 0x2000>;
  interrupts = <0 247 0>;
  #address-cells = <1>;
  #size-cells = <0>;
  clocks = <&clock 204>, <&clock 210>, <&clock 215>, <&clock 216>;
  clock-names = "biu", "gate_ciu", "dout_mmc_a", "dout_mmc_b";
  status = "disabled";
 };

 rtc@101E0000 {
  compatible = "samsung,s3c6410-rtc";
  reg = <0x0 0x101E0000 0x0 0x100>;
  interrupts = <0 92 0>, <0 93 0>;
  clocks = <&clock 1020>;
  clock-names = "gate_rtc";
  status = "disabled";
 };

 watchdog@101B0000 {
  compatible = "samsung,s3c2410-wdt";
  reg = <0x0 0x101B0000 0x0 0x100>;
  interrupts = <0 100 0>;
  clocks = <&clock 1030>, <&clock 1030>;
  clock-names = "rate_watchdog", "gate_watchdog";
  timeout-sec = <30>;
  pmu_wdt_reset_type = <1>;
 };

 usb@13580000 {
  compatible = "samsung,exynos_udc";
  reg = <0x0 0x13580000 0x0 0x1000>;
  interrupts = <0 238 0>;
  clocks = <&clock 300>, <&clock 301>, <&clock 302>,
           <&clock 303>, <&clock 306>, <&clock 307>;
  clock-names = "otg_aclk", "otg_hclk", "upsizer_otg",
         "xiu_d_fsys1", "upsizer_fsys1", "upsizer_ahb_usbhs";
  usb-phy = <&usb2_phy>;
 };

 ehci: usb@13510000 {
  compatible = "samsung,exynos7580-ehci";
  reg = <0x0 0x13510000 0x0 0x100>;
  interrupts = <0 239 0>;
  clocks = <&clock 300>, <&clock 303>, <&clock 304>,
         <&clock 305>, <&clock 306>, <&clock 307>, <&clock 308>;
  clock-names = "otg_aclk", "xiu_d_fsys1", "ahb_usbhs",
   "ahb2axi_usbhs", "upsizer_fsys1", "upsizer_ahb_usbhs","usbhost20";
  usb-phy = <&usb2_phy>;
  status = "ok";
 };

 ohci: usb@13520000 {
  compatible = "samsung,exynos7580-ohci";
  reg = <0x0 0x13520000 0x0 0x100>;
  clocks = <&clock 300>, <&clock 303>, <&clock 304>,
         <&clock 305>, <&clock 306>, <&clock 307>, <&clock 308>;
  clock-names = "otg_aclk", "xiu_d_fsys1", "ahb_usbhs",
   "ahb2axi_usbhs", "upsizer_fsys1", "upsizer_ahb_usbhs", "usbhost20";
  interrupts = <0 239 0>;
  usb-phy = <&usb2_phy>;
  status = "ok";
 };

 usb2_phy: usb2phy@135c0000 {
  #address-cells = <2>;
  #size-cells = <2>;
  compatible = "samsung,exynos7580-dwc-usb2phy";
  reg = <0x0 0x135c0000 0x0 0x100>;
  clocks = <&clock 2>, <&clock 403>, <&clock 300>, <&clock 301>,
         <&clock 302>, <&clock 303>, <&clock 306>, <&clock 307>,
         <&clock 400>, <&clock 401>, <&clock 402>;
  clock-names = "usb_pll", "phy_otg", "otg_aclk", "otg_hclk",
   "upsizer_otg", "xiu_d_fsys1", "upsizer_fsys1", "upsizer_ahb_usbhs",
   "freeclk", "phyclk", "clk48mohci";
  ranges;

  usbphy-sys {
   reg = <0x0 0x10460738 0x0 0xC>,
          <0x0 0x13721020 0x0 0xC>;
  };
 };

 usb-switch {
  compatible = "samsung,exynos7580-usb-switch";
  ehci = <&ehci>;
  ohci = <&ohci>;
 };

 amba {
  #address-cells = <2>;
  #size-cells = <2>;
  compatible = "arm,amba-bus";
  interrupt-parent = <&gic>;
  ranges;

  pdma0: pdma0@13650000 {
   compatible = "arm,pl330", "arm,primecell";
   reg = <0x0 0x13650000 0x0 0x1000>;
   interrupts = <0 228 0>;
   clocks = <&clock 200>;
   clock-names = "apb_pclk";
   #dma-cells = <1>;
   #dma-channels = <8>;
   #dma-requests = <32>;
  };

  pdma1: pdma1@13660000 {
   compatible = "arm,pl330", "arm,primecell";
   reg = <0x0 0x13660000 0x0 0x1000>;
   interrupts = <0 229 0>;
   clocks = <&clock 201>;
   clock-names = "apb_pclk";
   #dma-cells = <1>;
   #dma-channels = <4>;
   #dma-requests = <32>;
  };

  adma: adma@11020000 {
   compatible = "arm,pl330", "arm,primecell";
   reg = <0x0 0x11020000 0x0 0x1000>;
   interrupts = <0 73 0>;
   clocks = <&clock 140>;
   clock-names = "apb_pclk";
   #dma-cells = <1>;
   #dma-channels = <6>;
   #dma-requests = <16>;
   #dma-mcode-addr = <0x03009000>;
  };
 };

 exynos_adc: adc@13900000 {
  compatible = "samsung,exynos-adc-v2";
  reg = <0x0 0x13900000 0x0 0x100>;
  interrupts = <0 439 0>;
  #io-channel-cells = <1>;
  io-channel-ranges;
  clocks = <&clock 1032>;
  clock-names = "gate_adcif";
 };

 spi_0: spi@13910000 {
  compatible = "samsung,exynos758x-spi";
  reg = <0x0 0x13910000 0x0 0x100>;
  interrupts = <0 432 0>;
  dma-mode;
  dmas = <&pdma0 9
   &pdma0 8>;
  dma-names = "tx", "rx";
  swap-mode;
  clocks = <&clock 90>, <&clock 80>;
  clock-names = "spi", "spi_busclk0";
  pinctrl-names = "default";
  pinctrl-0 = <&spi0_bus>;
  status = "disabled";
 };

 spi_1: spi@13920000 {
  compatible = "samsung,exynos758x-spi";
  reg = <0x0 0x13920000 0x0 0x100>;
  interrupts = <0 433 0>;
  dma-mode;
  dmas = <&pdma0 11
   &pdma0 10>;
  dma-names = "tx", "rx";
  swap-mode;
  clocks = <&clock 91>, <&clock 81>;
  clock-names = "spi", "spi_busclk0";
  pinctrl-names = "default";
  pinctrl-0 = <&spi1_bus>;
  status = "disabled";
 };

 spi_2: spi@13930000 {
  compatible = "samsung,exynos758x-spi";
  reg = <0x0 0x13930000 0x0 0x100>;
  interrupts = <0 434 0>;
  dma-mode;
  dmas = <&pdma0 13
   &pdma0 12>;
  dma-names = "tx", "rx";
  swap-mode;
  clocks = <&clock 92>, <&clock 82>;
  clock-names = "spi", "spi_busclk0";
  pinctrl-names = "default";
  pinctrl-0 = <&spi2_bus>;
  status = "disabled";
 };

 low-power-mode {
  compatible = "samsung,low-power-mode";

  lpc-reg = <0x10464064>, <0x10464084>, <0x10464184>;
  lpc-val = <0xF>, <0xF>, <0xF>;

  lpm-reg = <0x10464064>, <0x10464084>, <0x10464184>;
  lpm-val = <0xF>, <0xF>, <0xF>;
 };

 sec_pwm: pwm@13970000 {
  compatible = "samsung,s3c6400-pwm";
  reg = <0x0 0x13970000 0x0 0x1000>;
  #pwm-cells = <3>;
  clocks = <&clock 1031>,
         <&clock_pwm 1>, <&clock_pwm 2>,
         <&clock_pwm 5>, <&clock_pwm 6>,
         <&clock_pwm 7>, <&clock_pwm 8>,
         <&clock_pwm 10>, <&clock_pwm 11>,
         <&clock_pwm 12>, <&clock_pwm 13>;
  clock-names = "gate_timers",
   "pwm-scaler0", "pwm-scaler1",
   "pwm-tdiv0", "pwm-tdiv1",
   "pwm-tdiv2", "pwm-tdiv3",
   "pwm-tin0", "pwm-tin1",
   "pwm-tin2", "pwm-tin3";
  status = "ok";
 };

 eax: eax {
  compatible = "samsung,exynos-amixer";
  status = "ok";
 };

 i2s0: i2s@11040000 {
  compatible = "samsung,i2s-v5";
  reg = <0x0 0x11040000 0x0 0x100>;
  dmas = <&adma 0
   &adma 2>;
  dma-names = "tx", "rx";
  interrupts = <0 69 0>;
  clocks = <&clock 150>,
    <&clock 151>,
    <&clock 151>;
  clock-names = "iis", "i2s_opclk0", "i2s_opclk1";
  samsung,supports-6ch;
  samsung,supports-rstclr;
  samsung,supports-secdai;
  samsung,supports-tdm;
  samsung,supports-low-rfs;
  samsung,amixer = <2>;
  samsung,lpass-subip;
  status = "disabled";
  i2s-sec {
   dmas = <&adma 1>;
   dma-names = "tx-sec";
   clocks = <&clock 150>,
     <&clock 151>,
     <&clock 151>;
   clock-names = "iis", "i2s_opclk0", "i2s_opclk1";
   samsung,tx-buf = <0x03000000>;
   samsung,tx-size = <0x9000>;
   samsung,tx-deepbuf-size = <0x9000>;
   samsung,tx-uhqa-buf = <0x40000000 0x40000>;
  };
 };

 clock_pwm: pwm-clock-controller@13970000 {
  compatible = "samsung,exynos-pwm-clock";
  reg = <0x0 0x13970000 0x0 0x50>;
  #clock-cells = <1>;
 };

 mali@0x11400000 {
  compatible = "arm,mali";
  reg = <0x0 0x11400000 0x0 0x5000>;
  interrupts = <0 282 0>, <0 283 0>, <0 281 0>;
  interrupt-names = "JOB", "MMU", "GPU";
  clocks = <&clock 1>, <&clock 10>, <&clock 160>,
   <&clock 161>, <&clock 162>, <&clock 163>;
  clock-names = "fin_pll", "fout_g3d_pll", "aclk_g3d",
   "mout_g3d", "dout_aclk_g3d", "aclk_g3d_400";
  samsung,power-domain = <&pd_g3d>;
 };

 decon_0: decon_fb@14830000 {
  compatible = "samsung,exynos5-decon_driver";
  reg = <0x0 0x14830000 0x0 0x8000>;
  #pb-id-cells = <4>;
  samsung,power-domain = <&pd_disp>;


  interrupts = <0 203 0>, <0 201 0>, <0 202 0>;


  clocks =

   <&clock 11>,
   <&clock 35>,


   <&clock ((3600) + 1)>,
   <&clock ((3600) + 2)>,
   <&clock ((3600) + 8)>,

   <&clock ((3600) + 13)>,
   <&clock ((3600) + 5)>,
   <&clock ((3600) + 16)>,
   <&clock ((3600) + 25)>,
   <&clock ((3600) + 23)>,
   <&clock ((3600) + 16)>,


   <&clock ((3600) + 6)>,
   <&clock ((3600) + 17)>,
   <&clock ((3600) + 26)>,
   <&clock ((3600) + 29)>,


   <&clock ((3600) + 19)>,
   <&clock ((3600) + 0)>,
   <&clock ((3600) + 12)>,
   <&clock ((3600) + 7)>,
   <&clock ((3600) + 18)>,


   <&clock ((3600) + 15)>,
   <&clock ((3600) + 21)>,
   <&clock 19>;

  clock-names =

   "disp_pll", "bus_pll",


   "mout_sclk_disp_decon_int_eclk_a",
   "mout_sclk_disp_decon_int_eclk_b",
   "mout_sclk_decon_int_eclk_user",
   "dout_sclk_disp_decon_int_eclk", "m_decon0_eclk", "d_decon0_eclk", "decon0_eclk",
   "sclk_disp_decon_int_eclk", "mout_sclk_decon_int_eclk",


   "m_decon0_vclk", "d_decon0_vclk", "decon0_vclk", "aclk_disp_200",


   "aclk_disp", "mout_aclk_disp_200", "dout_aclk_disp_200",
   "mout_aclk_disp_200_user", "aclk_decon0",


   "d_pclk_disp", "pclk_decon0", "mif_pll";

  ip_ver = <4>;
  max_win = <3>;
  n_sink_pad = <3>;
  n_src_pad = <1>;
  default_win = <0>;
  trig_mode = <0>;
  dsi_mode = <0>;

  status = "disabled";

  #address-cells = <2>;
  #size-cells = <2>;
  ranges;

  cam-stat {

   reg = <0x0 0x10464144 0x0 0x4>;
  };

 };

 mdev_0: mdev_output {
  compatible = "samsung,exynos5-mdev";
 };

 dsim_0: dsim@14800000 {
  compatible = "samsung,exynos5-mipi-dsi";
  reg = <0x0 0x14800000 0x0 0x1000>;
  interrupts = <0 207 0>;
  samsung,power-domain = <&pd_disp>;

  status = "disabled";

  clocks = <&clock ((3600) + 22)>,
    <&clock ((3600) + 28)>,
    <&clock ((3600) + 27)>,
    <&clock ((3600) + 20)>,
    <&clock ((3600) + 21)>;

  clock-names = "pclk_dsim0", "mipi0_rx", "mipi0_bit",

   "rgb_vclk0",

   "pclk_disp";

  pinctrl-names = "turnon_tes", "turnoff_tes";
  pinctrl-0 = <&disp_teson>;
  pinctrl-1 = <&disp_tesoff>;


  data_lane_cnt = <4>;
 };

 fimc_is_sensor0: fimc_is_sensor@144a0000 {
  compatible = "samsung,exynos5-fimc-is-sensor";
  #pb-id-cells = <3>;
  reg = <0x0 0x144a0000 0x0 0x10000>, <0x0 0x144c0000 0x0 0x10000>;
  interrupts = <0 137 0>;
  samsung,power-domain = <&pd_isp>;
  clock-names = "oscclk",
   "dout_sclk_isp_sensor0_a",
   "dout_sclk_isp_sensor0_b",
   "dout_sclk_isp_sensor1_a",
   "dout_sclk_isp_sensor1_b",

   "mout_sclk_isp_sensor0",
   "mout_sclk_isp_sensor1",

   "mout_phyclk_csi_link0_rx_user",
   "mout_phyclk_csi_link1_rx_user",

   "phyclk_csi_phy0_rxbyteclkhs0",

   "aclk_csi_link0_1_wrap_clk",
   "aclk_csi_link1_1_wrap_clk",
   "aclk_fimc_bns_aclk",
   "aclk_fimc_bns_l_aclk",

   "aclk_sasync_fimc_bns_m_to_bus",
   "aclk_sasync_fimc_bns_l_to_bus",
   "aclk_masync_fimc_bns_m_to_bus",
   "aclk_masync_fimc_bns_l_to_bus",

   "sclk_isp_sensor0",
   "sclk_isp_sensor1";
  clocks = <&clock 1>,
   <&clock 2021>,
   <&clock 2022>,

   <&clock 2023>,

   <&clock 2024>,
   <&clock 2040>,
   <&clock 2041>,

   <&clock 2048>,
   <&clock 2049>,

   <&clock 2060>,

   <&clock 2100>,
   <&clock 2101>,
   <&clock 2102>,
   <&clock 2103>,

   <&clock 2104>,
   <&clock 2105>,
   <&clock 2106>,
   <&clock 2107>,

   <&clock 2110>,
   <&clock 2111>;
 };

 fimc_is_sensor1: fimc_is_sensor@144b0000 {
  compatible = "samsung,exynos5-fimc-is-sensor";
  #pb-id-cells = <3>;
  reg = <0x0 0x144b0000 0x0 0x10000>, <0x0 0x144d0000 0x0 0x10000>;
  interrupts = <0 138 0>;
  samsung,power-domain = <&pd_isp>;
  clock-names = "oscclk",
   "dout_sclk_isp_sensor0_a",
   "dout_sclk_isp_sensor0_b",
   "dout_sclk_isp_sensor1_a",
   "dout_sclk_isp_sensor1_b",

   "mout_sclk_isp_sensor0",
   "mout_sclk_isp_sensor1",

   "mout_phyclk_csi_link0_rx_user",
   "mout_phyclk_csi_link1_rx_user",

   "phyclk_csi_phy0_rxbyteclkhs0",

   "aclk_csi_link0_1_wrap_clk",
   "aclk_csi_link1_1_wrap_clk",
   "aclk_fimc_bns_aclk",
   "aclk_fimc_bns_l_aclk",

   "aclk_sasync_fimc_bns_m_to_bus",
   "aclk_sasync_fimc_bns_l_to_bus",
   "aclk_masync_fimc_bns_m_to_bus",
   "aclk_masync_fimc_bns_l_to_bus",

   "sclk_isp_sensor0",
   "sclk_isp_sensor1";
  clocks = <&clock 1>,
   <&clock 2021>,
   <&clock 2022>,

   <&clock 2023>,

   <&clock 2024>,
   <&clock 2040>,
   <&clock 2041>,

   <&clock 2048>,
   <&clock 2049>,

   <&clock 2060>,

   <&clock 2100>,
   <&clock 2101>,
   <&clock 2102>,
   <&clock 2103>,

   <&clock 2104>,
   <&clock 2105>,
   <&clock 2106>,
   <&clock 2107>,

   <&clock 2110>,
   <&clock 2111>;
 };

 fimc_is: fimc_is@14400000 {
  compatible = "samsung,exynos5-fimc-is";
  #pb-id-cells = <3>;
  reg = <0x0 0x14580000 0x0 0x10000>;
  interrupts = <0 146 0>,
      <0 147 0>;
  samsung,power-domain = <&pd_isp>;
  clocks = <&clock 1>,

  <&clock 20>,

  <&clock 2000>,
  <&clock 2001>,
  <&clock 2002>,
  <&clock 2003>,
  <&clock 2004>,
  <&clock 2005>,
  <&clock 2006>,
  <&clock 2007>,
  <&clock 2008>,
  <&clock 2009>,
  <&clock 2010>,
  <&clock 2011>,
  <&clock 2012>,
  <&clock 2013>,
  <&clock 2014>,
  <&clock 2015>,
  <&clock 2016>,
  <&clock 2017>,
  <&clock 2018>,
  <&clock 2019>,
  <&clock 2020>,

  <&clock 2025>,
  <&clock 2026>,
  <&clock 2027>,
  <&clock 2028>,
  <&clock 2029>,
  <&clock 2030>,
  <&clock 2031>,
  <&clock 2032>,
  <&clock 2033>,
  <&clock 2034>,
  <&clock 2035>,
  <&clock 2036>,
  <&clock 2037>,
  <&clock 2038>,
  <&clock 2039>,

  <&clock 2042>,
  <&clock 2043>,
  <&clock 2044>,
  <&clock 2045>,
  <&clock 2046>,
  <&clock 2047>,
  <&clock 2048>,
  <&clock 2049>,

  <&clock 2060>;

  clock-names = "oscclk",

   "isp_pll",

   "dout_isp_pll_div2",
   "dout_isp_pll_div3",
   "dout_sclk_cpu_isp_clkin",
   "dout_sclk_cpu_isp_atclkin",
   "dout_sclk_cpu_isp_pclkdbg",
   "dout_pclk_csi_link0_225",
   "dout_aclk_link_data",
   "dout_aclk_csi_link1_75",
   "dout_pclk_csi_link1_37",
   "dout_aclk_fimc_isp_450",
   "dout_pclk_fimc_isp_225",
   "dout_aclk_fimc_fd_300",
   "dout_pclk_fimc_fd_150",
   "dout_aclk_isp_266",
   "dout_aclk_isp_133",
   "dout_aclk_isp_67",
   "dout_sclk_isp_spi0_ext_clk_a",
   "dout_sclk_isp_spi0_ext_clk_b",
   "dout_sclk_isp_spi1_ext_clk_a",
   "dout_sclk_isp_spi1_ext_clk_b",
   "dout_sclk_isp_uart_ext_uclk",

   "mout_sclk_cpu_isp_clkin_a",
   "mout_sclk_cpu_isp_clkin_b",
   "mout_aclk_link_data_a",
   "mout_aclk_link_data_b",
   "mout_aclk_link_data_c",
   "mout_aclk_csi_link1_75",
   "mout_aclk_csi_link1_75_b",
   "mout_aclk_fimc_isp_450_a",
   "mout_aclk_fimc_isp_450_b",
   "mout_aclk_fimc_isp_450_c",
   "mout_aclk_fimc_isp_450_d",
   "mout_aclk_fimc_fd_300",
   "mout_sclk_isp_spi0_ext_clk",
   "mout_sclk_isp_spi1_ext_clk",
   "mout_sclk_isp_uart_ext_uclk",


   "mout_aclk_isp_400_user",
   "mout_aclk_isp_333_user",
   "mout_aclk_isp_266_user",
   "mout_sclk_spi0_isp_ext_clk_user",
   "mout_sclk_spi1_isp_ext_clk_user",
   "mout_sclk_uart_isp_ext_clk_user",
   "mout_phyclk_csi_link0_rx_user",
   "mout_phyclk_csi_link1_rx_user",

   "phyclk_csi_phy0_rxbyteclkhs0";
  clk_gate_strs = "gate_3aa1",
    "gate_isp",
    "gate_drc",
    "gate_scalerc",
    "gate_dis",
    "gate_3dnr",
    "gate_scalerp",
    "gate_fd",
    "gate_3aa0";
  clk_gate_ctrl {

   group0 {
   };

   group1 {

   };

   group2 {
   };
  };
 };

 iommu-domain_fimc-is {
  compatible = "samsung,exynos-iommu-bus";
  #address-cells = <2>;
  #size-cells = <2>;
  ranges;

  domain-clients = <&fimc_is>,
     <&fimc_is_sensor0>,
     <&fimc_is_sensor1>;

  sysmmu_isp0: sysmmu@0x14660000 {
    compatible = "samsung,exynos7420-sysmmu";
    reg = <0x0 0x14660000 0x0 0x1000>;
    interrupts = <0 128 0>;
    qos = <15>;
    clocks = <&clock 2070>,
      <&clock 2070>;
    clock-names = "aclk", "pclk";
    sysmmu,block-when-stop;
    pb-info {
     pb@0 {
      master_axi_id_list = <&fimc_is_sensor0 ((0) + 0x8000) ((1) + 0x8000) ((2) + 0x8000)>,
             <&fimc_is_sensor1 ((0) + 0x8000) ((1) + 0x8000) ((2) + 0x8000)>;
     };
    };
   };

  sysmmu_isp1: sysmmu@0x14670000 {
    compatible = "samsung,exynos7420-sysmmu";
    reg = <0x0 0x14670000 0x0 0x1000>;
    interrupts = <0 131 0>;
    qos = <15>;
    clocks = <&clock 2070>,
      <&clock 2070>;
    clock-names = "aclk", "pclk";
    sysmmu,block-when-stop;
    sysmmu,acg_disable;
    pb-info {
     pb@0 {
      master_axi_id_list = <&fimc_is (0) ((0) + 0x8000) ((2) + 0x8000)>;
     };

     pb@1 {
      master_axi_id_list = <&fimc_is ((1) + 0x8000) ((3) + 0x8000) ((5) + 0x8000)>;
     };
   };
  };

  sysmmu_isp2: sysmmu@0x14680000 {
    compatible = "samsung,exynos7420-sysmmu";
    reg = <0x0 0x14680000 0x0 0x1000>;
    interrupts = <0 134 0>;
    clocks = <&clock 2070>,
      <&clock 2070>;
    clock-names = "aclk", "pclk";
    sysmmu,block-when-stop;
    pb-info {
     pb@0 {
      master_axi_id_list = <&fimc_is 65536 65536 65536>;
     };
    };
   };

  sysmmu_isp3: sysmmu@0x14690000 {
    compatible = "samsung,exynos7420-sysmmu";
    reg = <0x0 0x14690000 0x0 0x1000>;
    interrupts = <0 126 0>;
    qos = <15>;
    clocks = <&clock 2070>,
      <&clock 2070>;
    clock-names = "aclk", "pclk";
    sysmmu,block-when-stop;
    pb-info {
     pb@0 {
      master_axi_id_list = <&fimc_is 65536 65536 65536>;
     };
    };
  };
 };

 iommu-domain_disp {
  compatible = "samsung,exynos-iommu-bus";
  #address-cells = <2>;
  #size-cells = <2>;
  ranges;

  domain-clients = <&decon_0>;

  sysmmu_disp_mmu: sysmmu@14860000 {
   compatible = "samsung,exynos7420-sysmmu";
   reg = <0x0 0x14860000 0x0 0x1000>;
   interrupts = <0 192 0>;
   qos = <15>;
   clocks = <&clock ((3000) + 2)>,
     <&clock ((3000) + 3)>;
   clock-names = "aclk", "pclk";

   pb-info {
    pb@0 {
     master_axi_id_list = <&decon_0 (0) (1) (2) (8)>;
    };
   };
  };
 };

 iommu-domain_mscl {
  compatible = "samsung,exynos-iommu-bus";
  #address-cells = <2>;
  #size-cells = <2>;
  ranges;

  domain-clients = <&scaler_0>, <&scaler_1>, <&mfc_0>, <&jpeg_0>;

  sysmmu_mscl_mmu: sysmmu@12C90000 {
   compatible = "samsung,exynos7420-sysmmu";
   reg = <0x0 0x12C90000 0x0 0x1000>;
   interrupts = <0 402 0>;
   clocks = <&clock ((3000) + 0)>,
     <&clock ((3000) + 1)>;
   clock-names = "aclk", "pclk";
   sysmmu,acg_disable;
   pb-info {
    pb@0 {
     master_axi_id_list = <&scaler_0>, <&jpeg_0>;
    };
    pb@1 {
     master_axi_id_list = <&scaler_1>;
    };
   };
  };

  sysmmu_mfc_mmu: sysmmu@12840000 {
   compatible = "samsung,exynos7420-sysmmu";
   reg = <0x0 0x12840000 0x0 0x1000>;
   interrupts = <0 352 0>;
   clocks = <&clock ((3000) + 4)>,
     <&clock ((3000) + 5)>;
   clock-names = "aclk", "pclk";
   pb-info {
    pb@0 {
     master_axi_id_list = <&mfc_0>;
    };
   };
  };
 };

 mailbox: mcu_ipc@104B0000 {
   compatible = "samsung,exynos7580-mailbox";
   reg = <0x0 0x104B0000 0x0 0x0180>;
   mcu,name = "mcu_ipc";
   mcu,id = <1>;
   interrupts = <0 383 0 >;
 };

 pd_g3d: pd-g3d@10464060 {
  compatible = "samsung,exynos-pd";
  reg = <0x0 0x10464060 0x0 0x20>;
  pd-option = <0x1>;
 };

 pd_mfcmscl: pd-mfcmscl@10464180 {
  compatible = "samsung,exynos-pd";
  reg = <0x0 0x10464180 0x0 0x20>;
  pd-option = <0x2>;
  spd_mfc: spd-mfc@10464180 {
   compatible = "samsung,exynos-spd";
   bts-status = "enabled";
  };
  spd_mscl0: spd-mscl0@10464180 {
   compatible = "samsung,exynos-spd";
  };
  spd_mscl1: spd-mscl1@10464180 {
   compatible = "samsung,exynos-spd";
  };
  spd_jpeg: spd-jpeg@10464180 {
   compatible = "samsung,exynos-spd";
  };
 };

 pd_aud: pd-aud@104640C0 {
  compatible = "samsung,exynos-pd";
  reg = <0x0 0x104640C0 0x0 0x20>;
  pd-option = <0x2>;
  status = "disabled";

  spd_aud: spd-aud@10464180 {
   compatible = "samsung,exynos-spd";
  };
 };

 pd_disp: pd-disp@10464080 {
  compatible = "samsung,exynos-pd";
  reg = <0x0 0x10464080 0x0 0x20>;
  pd-option = <0x2>;
  bts-status = "enabled";
 };

 pd_isp: pd-isp@10464140 {
  compatible = "samsung,exynos-pd";
  reg = <0x0 0x10464140 0x0 0x20>;
  pd-option = <0x2>;
  bts-status = "enabled";
 };

 mfc_0: mfc0@12800000 {
  compatible = "samsung,mfc-v6";
  reg = <0x0 0x12800000 0x0 0x10000>;
  interrupts = <0 354 0>;
  samsung,power-domain = <&spd_mfc>;
  #pb-id-cells = <0>;

  clock-names = "aclk_mfc", "aclk_mfcmscl_266",
    "pclk_sasync_ahb2apb_mfc", "pclk_mfc",
    "aclk_bus_d_mfc", "aclk_upsizer_mfc",
    "aclk_sasync_ahb2apb_mfc", "aclk_ahb2apb_mfc";
  clocks = <&clock ((3200) + 0)>, <&clock ((3200) + 1)>,
   <&clock ((3200) + 5)>, <&clock ((3200) + 6)>,
   <&clock ((3200) + 7)>, <&clock ((3200) + 8)>,
   <&clock ((3200) + 10)>, <&clock ((3200) + 11)>;
  status = "ok";
  ip_ver = <12>;
  clock_rate = <266000000>;
  min_rate = <100000>;
  num_qos_steps = <3>;
  mfc_qos_table {
   mfc_qos_variant_0 {
    thrd_mb = <0>;
    freq_mfc = <0>;
    freq_int = <100000>;
    freq_mif = <416000>;
    freq_cpu = <0>;
    freq_kfc = <0>;
    has_enc_table = <0>;
   };
   mfc_qos_variant_1 {
    thrd_mb = <108000>;
    freq_mfc = <0>;
    freq_int = <200000>;
    freq_mif = <559000>;
    freq_cpu = <0>;
    freq_kfc = <0>;
    has_enc_table = <0>;
   };
   mfc_qos_variant_2 {
    thrd_mb = <108000>;
    freq_mfc = <0>;
    freq_int = <160000>;
    freq_mif = <416000>;
    freq_cpu = <0>;
    freq_kfc = <0>;
    has_enc_table = <1>;
   };
  };
 };

 jpeg_0: jpeg@12C20000 {
  compatible = "samsung,jpeg-hx2";
  reg = <0x0 0x12C20000 0x0 0x1000>;
  interrupts = <0 404 0>;
  samsung,power-domain = <&spd_jpeg>;
  #pb-id-cells = <0>;
  clock-names = "jpeg", "mout_aclk_mscl_400_user", "aclk_mfcmscl_400",
    "pclk_ahb_jpeg";
  clocks = <&clock ((3500) + 6)>, <&clock ((3500) + 5)>,
   <&clock ((3500) + 4)>, <&clock ((3500) + 7)>;
  ip_ver = <2>;
        };
};
# 15 "arch/arm64/boot/dts/exynos7580-j7e3g_rev00.dts" 2
# 1 "arch/arm64/boot/dts/modem-isla-pdata.dtsi" 1
# 12 "arch/arm64/boot/dts/modem-isla-pdata.dtsi"
/ {

 mif_pdata {
  compatible = "sec_modem,modem_pdata";
  status = "okay";
  interrupts = <0 18 0>, <0 479 0>;

  mif,int_ap2cp_msg = <0>;
  mif,int_ap2cp_wakeup = <1>;
  mif,int_ap2cp_status = <2>;
  mif,int_ap2cp_active = <3>;

  mif,irq_cp2ap_msg = <0>;
  mif,irq_cp2ap_wakeup = <1>;
  mif,irq_cp2ap_status = <2>;
  mif,irq_cp2ap_perf_req = <3>;
  mif,irq_cp2ap_active = <4>;

  mbx_ap2cp_msg = <0>;
  mbx_cp2ap_msg = <1>;
  mbx_ap2cp_wakeup = <2>;
  mbx_cp2ap_wakeup = <3>;
  mbx_ap2cp_status = <4>;
  mbx_cp2ap_status = <5>;
  mbx_ap2cp_active = <6>;
  mbx_cp2ap_dvfsreq = <7>;
  mbx_cp2ap_active = <9>;
  mbx_ap2cp_info_value = <33>;
  mbx_ap2cp_lock_value = <39>;

  mif,name = "ss310ap";
  mif,modem_net = <0>;
  mif,modem_type = <10>;
  mif,use_handover = <0>;
  mif,ipc_version = <50>;
  mif,link_types = <0x200>;
  mif,link_name = "shmem";
  mif,link_attrs = <0x7C8>;
  mif,num_iodevs = <18>;
  iodevs {
   io_device_0 {
    iod,name = "umts_ipc0";
    iod,id = <235>;
    iod,format = <0>;
    iod,io_type = <0>;
    iod,links = <0x200>;
    iod,attrs = <0x2>;
   };
   io_device_1 {
    iod,name = "umts_ipc1";
    iod,id = <236>;
    iod,format = <0>;
    iod,io_type = <0>;
    iod,links = <0x200>;
    iod,attrs = <0x402>;
   };
   io_device_2 {
    iod,name = "umts_rfs0";
    iod,id = <245>;
    iod,format = <1>;
    iod,io_type = <0>;
    iod,links = <0x200>;
    iod,attrs = <0x2>;
   };
   io_device_3 {
    iod,name = "umts_csd";
    iod,id = <1>;
    iod,format = <1>;
    iod,io_type = <0>;
    iod,links = <0x200>;
    iod,attrs = <0x02>;
   };
   io_device_4 {
    iod,name = "umts_router";
    iod,id = <25>;
    iod,format = <1>;
    iod,io_type = <0>;
    iod,links = <0x200>;
    iod,attrs = <0x2>;
   };
   io_device_5 {
    iod,name = "umts_dm0";
    iod,id = <28>;
    iod,format = <1>;
    iod,io_type = <0>;
    iod,links = <0x200>;
    iod,attrs = <0x2>;
   };
   io_device_6 {
    iod,name = "ipc_loopback0";
    iod,id = <244>;
    iod,format = <0>;
    iod,io_type = <0>;
    iod,links = <0x200>;
    iod,attrs = <0x2>;
   };
   io_device_7 {
    iod,name = "rmnet0";
    iod,id = <10>;
    iod,format = <1>;
    iod,io_type = <1>;
    iod,links = <0x200>;
    iod,attrs = <0x2>;
   };
   io_device_8 {
    iod,name = "rmnet1";
    iod,id = <11>;
    iod,format = <1>;
    iod,io_type = <1>;
    iod,links = <0x200>;
    iod,attrs = <0x2>;
   };
   io_device_9 {
    iod,name = "rmnet2";
    iod,id = <12>;
    iod,format = <1>;
    iod,io_type = <1>;
    iod,links = <0x200>;
    iod,attrs = <0x2>;
   };
   io_device_10 {
    iod,name = "rmnet3";
    iod,id = <13>;
    iod,format = <1>;
    iod,io_type = <1>;
    iod,links = <0x200>;
    iod,attrs = <0x2>;
   };
   io_device_11 {
    iod,name = "rmnet4";
    iod,id = <14>;
    iod,format = <1>;
    iod,io_type = <1>;
    iod,links = <0x200>;
    iod,attrs = <0x402>;
   };
   io_device_12 {
    iod,name = "rmnet5";
    iod,id = <15>;
    iod,format = <1>;
    iod,io_type = <1>;
    iod,links = <0x200>;
    iod,attrs = <0x402>;
   };
   io_device_13 {
    iod,name = "rmnet6";
    iod,id = <16>;
    iod,format = <1>;
    iod,io_type = <1>;
    iod,links = <0x200>;
    iod,attrs = <0x402>;
   };
   io_device_14 {
    iod,name = "rmnet7";
    iod,id = <17>;
    iod,format = <1>;
    iod,io_type = <1>;
    iod,links = <0x200>;
    iod,attrs = <0x402>;
   };
   io_device_15 {
    iod,name = "multipdp";
    iod,id = <0>;
    iod,format = <3>;
    iod,io_type = <2>;
    iod,links = <0x200>;
    iod,attrs = <0x2>;
   };
   io_device_16 {
    iod,name = "umts_boot0";
    iod,id = <215>;
    iod,format = <4>;
    iod,io_type = <0>;
    iod,links = <0x200>;
    iod,attrs = <0x02>;
   };
   io_device_17 {
    iod,name = "umts_ramdump0";
    iod,id = <225>;
    iod,format = <5>;
    iod,io_type = <0>;
    iod,links = <0x200>;
    iod,attrs = <0x202>;
   };
  };
 };

 mailbox: mcu_ipc@104B0000 {
  compatible = "samsung,exynos7580-mailbox";

  reg = <0x0 0x104B0000 0x0 0x17C>;
  interrupts = <0 383 0 >;

  mcu,id = <1>;
  mcu,name = "mcu_ipc";
  mcu,irq_affinity_mask = <3>;
 };

 shmem: shmem@90000000 {
  compatible = "samsung,exynos7580-shm_ipc";

  reg = <0x0 0x90000000 0x0 0x5c00000>;

  shmem,ipc_offset = <0x5800000>;
  shmem,ipc_size = <0x400000>;
 };
};
# 16 "arch/arm64/boot/dts/exynos7580-j7e3g_rev00.dts" 2
# 1 "arch/arm64/boot/dts/exynos7580-j7elte_battery.dtsi" 1
# 12 "arch/arm64/boot/dts/exynos7580-j7elte_battery.dtsi"
/ {
 pinctrl@139B0000 {
  fuel_irq: fuel-irq {
   samsung,pins = "gpa0-1";
   samsung,pin-function = <0>;
   samsung,pin-pud = <0>;
   samsung,pin-drv = <0>;
  };
 };

 pinctrl@139B0000 {
  if_pmic_irq: if-pmic-irq {
   samsung,pins = "gpa0-5";
   samsung,pin-function = <0>;
   samsung,pin-pud = <0>;
   samsung,pin-drv = <0>;
  };
 };

 pinctrl@139C0000 {
  chg_en: chg-en {
   samsung,pins = "gpd3-1";
   samsung,pin-function = <1>;
   samsung,pin-pud = <0>;
   samsung,pin-drv = <0>;
  };
 };

 hsi2c@13890000 {
  status = "okay";
  sm5703-fuelgauge@71 {
   compatible = "samsung,sm5703-fuelgauge";
   reg = <0x71>;
   pinctrl-names = "default";
   pinctrl-0 = <&fuel_irq>;
   fuelgauge,fuel_int = <&gpa0 1 0>;
   fuelgauge,fuel_alert_soc = <2>;
   fuelgauge,capacity_max = <990>;
   fuelgauge,capacity_max_margin = <70>;
   fuelgauge,capacity_min = <0>;
   fuelgauge,capacity_calculation_type = <28>;
   fuelgauge,type_str = "SDI";
  };
 };

 battery_params {
  battery,id = <0>;
  battery0,battery_type = <4400>;
  battery0,battery_table0 = <0x1400 0x1B33 0x1C0F 0x1D24 0x1D72 0x1D80 0x1DEC 0x1E19 0x1E5D 0x1ECC 0x1EF6 0x1F62 0x2004 0x20CC 0x22B0 0x2400>;
  battery0,battery_table1 = <0x1400 0x1B33 0x1C0F 0x1D24 0x1D72 0x1D80 0x1DEC 0x1E19 0x1E5D 0x1ECC 0x1EF6 0x1F62 0x2004 0x20CC 0x22B0 0x2400>;
  battery0,battery_table2 = <0x00 0x37 0x99 0x133 0x1CD 0x300 0x4CD 0x600 0x999 0xC99 0xD33 0xE66 0x10CC 0x1333 0x1800 0x1806>;
  battery0,temp_std = <25>;
  battery0,temp_offset = <10>;
  battery0,temp_offset_cal = <0x01>;
  battery0,rce_value = <0x0749 0x0580 0x371>;
  battery0,dtcd_value = <0x1>;
  battery0,rs_value = <0x1ae 0x47a 0x3800 0x00a4>;
  battery0,vit_period = <0x350a>;
  battery0,mix_value = <0x0503 0x0004>;
  battery0,topoff_soc = <0x0 0x05>;
  battery0,volt_cal = <0x8000>;
  battery0,curr_cal = <0x6900>;
  battery0,charge_offset_cal = <0x4>;
 };

 battery {
  status = "okay";

  pinctrl-names = "default";

  compatible = "samsung,sec-battery";
  battery,vendor = "SDI SDI";
  battery,charger_name = "sm5703-charger";
  battery,fuelgauge_name = "sm5703-fuelgauge";
  battery,technology = <2>;



  battery,chip_vendor = "LSI";
  battery,temp_adc_type = <1>;

  battery,polling_time = <10 30 30 30 3600>;

  battery,temp_table_adc = <332 342 352 363 373 383 393 403 414 424 434 450 466 482 498 515 530
     546 561 577 593 610 627 644 661 681 701 722 744 769 794 817 841 856 872
     924 966 1007 1022 1038 1068 1099 1136 1170 1205 1242 1288 1324 1360 1409 1459
     1495 1532 1568 1605 1642 1692 1743 1793 1844 1895 1933 1972 2010 2049 2088 2126
     2165 2203 2242 2281 2317 2353 2389 2425 2461 2509 2557 2605 2653 2702 2734 2767
     2800 2832 2865 2898 2931 2965 2998 3030 3060 3090 3118 3147 3177 3214 3239 3263
     3288 3313 3331 3349 3367 3386 3404 3409 3418 3426 3434 3442>;

  battery,temp_table_data = <900 890 880 870 860 850 840 830 820 810 800 790 780 770 760 750 740 730 720 710 700 690
        680 670 660 650 640 630 620 610 600 590 580 570 560 550 540 530 520 510 500 490 480 470
        460 450 440 430 420 410 400 390 380 370 360 350 340 330 320 310 300 290 280 270 260 250
        240 230 220 210 200 190 180 170 160 150 140 130 120 110 100 90 80 70 60 50 40 30 20 10
        0 (-10) (-20) (-30) (-40) (-50) (-60) (-70) (-80) (-90) (-100) (-110) (-120) (-130) (-140)
        (-150) (-160) (-170) (-180) (-190) (-200)>;

  battery,input_current_limit = <1500 0 0 1500 460 900 1000 460 1000 0 760 1450 1500 0 0 400 700 1300 300 1000 1500 0 1450 1000 1500 80 1500 1500 1400 450>;
  battery,fast_charging_current = <2000 0 0 2000 460 1200 1000 460 1200 0 900 1600 2000 0 0 400 700 1300 300 1000 1900 0 2000 1000 2000 80 1800 1000 1400 450>;
  battery,full_check_current_1st = <200 0 0 200 200 200 200 200 200 0 200 200 200 0 0 200 200 200 200 200 200 0 200 200 200 0 200 200 200 200>;
  battery,full_check_current_2nd = <2400 0 0 2400 2400 2400 2400 2400 2400 0 2400 2400 2400 0 0 2400 2400 2400 2400 2400 2400 0 2400 2400 2400 2400 2400 2400 2400 2400>;

  battery,inbat_voltage = <0>;
  battery,inbat_voltage_table_adc = <3120 3101 3061 3038 3001 2956 2920 2887 2856 2814
      2793 2754 2720 2677 2641 2613 2572 2531 2502 2467 2436>;
  battery,inbat_voltage_table_data = <438 435 430 425 420 415 410 405 400 395
      390 385 380 375 370 365 360 355 350 345 340>;

  battery,adc_check_count = <5>;

  battery,cable_check_type = <4>;
  battery,cable_source_type = <1>;
  battery,event_waiting_time = <600>;
  battery,polling_type = <1>;
  battery,monitor_initial_count = <0>;

  battery,battery_check_type = <1>;
  battery,check_count = <0>;
  battery,check_adc_max = <1440>;
  battery,check_adc_min = <0>;

  battery,ovp_uvlo_check_type = <3>;

  battery,thermal_source = <2>;

  battery,temp_check_type = <2>;
  battery,temp_check_count = <1>;
  battery,temp_highlimit_threshold_event = <800>;
  battery,temp_highlimit_recovery_event = <750>;
  battery,temp_high_threshold_event = <580>;
  battery,temp_high_recovery_event = <530>;
  battery,temp_low_threshold_event = <(-50)>;
  battery,temp_low_recovery_event = <0>;
  battery,temp_highlimit_threshold_normal = <800>;
  battery,temp_highlimit_recovery_normal = <750>;
  battery,temp_high_threshold_normal = <580>;
  battery,temp_high_recovery_normal = <530>;
  battery,temp_low_threshold_normal = <(-50)>;
  battery,temp_low_recovery_normal = <0>;
  battery,temp_highlimit_threshold_lpm = <800>;
  battery,temp_highlimit_recovery_lpm = <750>;
  battery,temp_high_threshold_lpm = <580>;
  battery,temp_high_recovery_lpm = <530>;
  battery,temp_low_threshold_lpm = <(-50)>;
  battery,temp_low_recovery_lpm = <0>;
  battery,full_check_type = <7>;
  battery,full_check_type_2nd = <3>;
  battery,full_check_count = <1>;
  battery,chg_gpio_full_check = <0>;
  battery,chg_polarity_full_check = <1>;




  battery,full_condition_type = <13>;
  battery,full_condition_soc = <93>;
  battery,full_condition_vcell = <4300>;

  battery,recharge_check_count = <2>;
  battery,recharge_condition_type = <4>;
  battery,recharge_condition_soc = <98>;
  battery,recharge_condition_vcell = <4350>;

  battery,charging_total_time = <21600>;
  battery,recharging_total_time = <5400>;
  battery,charging_reset_time = <0>;

  battery,always_enable;

  io-channels = <&exynos_adc 1>, <&exynos_adc 3>;
  io-channel-names = "adc-temp", "bat-id";
  #io-channel-cells = <1>;
  io-channel-ranges;

  battery,chg_float_voltage = <4400>;

  battery,self_discharging_en;
  battery,force_discharging_limit = <650>;
  battery,force_discharging_recov = <550>;
  battery,self_discharging_voltage_limit = <4250>;
  battery,discharging_adc_max = <2600>;
  battery,discharging_adc_min = <1700>;
  battery,discharging_ntc_limit = <2750>;

  battery,swelling_high_temp_block = <500>;
  battery,swelling_high_temp_recov = <450>;
  battery,swelling_low_temp_block = <50>;
  battery,swelling_low_temp_recov = <100>;
  battery,swelling_chg_current = <1800>;
  battery,swelling_drop_float_voltage = <4200>;
  battery,swelling_high_rechg_voltage = <4150>;
  battery,swelling_low_rechg_voltage = <4050>;
  battery,swelling_block_time = <600>;
 };

 i2c@49 {
  compatible = "i2c-gpio";
  gpios = <&gpd2 1 0
   &gpd2 0 0>;
  i2c-gpio,delay-us = <2>;
  #address-cells = <1>;
  #size-cells = <0>;
  status = "okay";

  sm5703-mfd@49 {
   compatible = "siliconmitus,sm5703mfd";
   reg = <0x49>;
   pinctrl-names = "default";
   pinctrl-0 = <&chg_en &if_pmic_irq>;
   sm5703,irq-gpio = <&gpa0 5 0>;

   sm5703_ldo1 {
    compatible = "siliconmitus,sm5703-ldo1";
    regulator-name = "VDDAF_2.8V_CAM";
    regulator-min-microvolt = <2750000>;
    regulator-max-microvolt = <2800000>;




   };

   sm5703_ldo2_reg: sm5703_ldo2 {
    compatible = "siliconmitus,sm5703-ldo2";
    regulator-name = "VDD_SENSOR_2P8";
    regulator-min-microvolt = <2800000>;
    regulator-max-microvolt = <2800000>;




   };

   sm5703_ldo3 {
    compatible = "siliconmitus,sm5703-ldo3";
    regulator-name = "none";
    regulator-min-microvolt = <3000000>;
    regulator-max-microvolt = <3000000>;




   };

   sm5703_buck {
    compatible = "siliconmitus,sm5703-buck";
    regulator-name = "VDD_VTCAM_1P2";
    regulator-min-microvolt = <1200000>;
    regulator-max-microvolt = <1200000>;




   };

   sm5703_fled {
    compatible = "siliconmitus,sm5703-fled";
    enable = <1 1>;
    flash_current = <1200>;
    movie_current = <150>;
    torch_current = <100>;
    sm5703,led1-gpio = <&gpe0 2 0>;
    sm5703,led2-gpio = <&gpe0 1 0>;
    pinctrl-names = "fled_default","fled_sleep";
    pinctrl-0 = <&fled_flash_active>;
    pinctrl-1 = <&fled_flash_sleep>;
   };
  };
 };

 charger {
  status = "disable";
  compatible = "siliconmitus,sm5703-charger";


  battery,charger_name = "sm5703-charger";
  battery,chg_gpio_en = <&gpd3 1 0>;
  battery,chg_polarity_en = <0>;
  battery,chg_gpio_status = <0>;
  battery,chg_polarity_status = <0>;
  battery,chg_float_voltage = <4400>;
  chg_autostop = <0>;
  chg_autoset = <1>;
  chg_aiclen = <0>;
  chg_aiclth = <4500>;
  fg_vol_val = <4350>;
  fg_soc_val = <95>;
  fg_curr_avr_val = <150>;
 };
};
# 17 "arch/arm64/boot/dts/exynos7580-j7e3g_rev00.dts" 2
# 1 "arch/arm64/boot/dts/exynos7580-j7elte_gpio_00.dtsi" 1
# 12 "arch/arm64/boot/dts/exynos7580-j7elte_gpio_00.dtsi"
# 1 "arch/arm64/boot/dts/exynos_gpio_config_macros.dtsi" 1
# 13 "arch/arm64/boot/dts/exynos7580-j7elte_gpio_00.dtsi" 2


&pinctrl_0 {
 pinctrl-names = "default";
 pinctrl-0 = <&initial0>;
 initial0: initial-state {
  gpa0-0 { samsung,pins = "gpa0-0"; samsung,pin-function = <0>; samsung,pin-pud = <1>; samsung,pin-drv = <0x0>; };
  gpa0-3 { samsung,pins = "gpa0-3"; samsung,pin-function = <0>; samsung,pin-pud = <1>; samsung,pin-drv = <0x0>; };
  gpa0-6 { samsung,pins = "gpa0-6"; samsung,pin-function = <0>; samsung,pin-pud = <1>; samsung,pin-drv = <0x0>; };
  gpa0-7 { samsung,pins = "gpa0-7"; samsung,pin-function = <0>; samsung,pin-pud = <1>; samsung,pin-drv = <0x0>; };

  gpa1-1 { samsung,pins = "gpa1-1"; samsung,pin-function = <0>; samsung,pin-pud = <1>; samsung,pin-drv = <0x0>; };
  gpa1-2 { samsung,pins = "gpa1-2"; samsung,pin-function = <0>; samsung,pin-pud = <1>; samsung,pin-drv = <0x0>; };
  gpa1-5 { samsung,pins = "gpa1-5"; samsung,pin-function = <0>; samsung,pin-pud = <1>; samsung,pin-drv = <0x0>; };
  gpa1-6 { samsung,pins = "gpa1-6"; samsung,pin-function = <0>; samsung,pin-pud = <1>; samsung,pin-drv = <0x0>; };
  gpa1-7 { samsung,pins = "gpa1-7"; samsung,pin-function = <0>; samsung,pin-pud = <1>; samsung,pin-drv = <0x0>; };

  gpa2-4 { samsung,pins = "gpa2-4"; samsung,pin-function = <0>; samsung,pin-pud = <1>; samsung,pin-drv = <0x0>; };

  gpa3-0 { samsung,pins = "gpa3-0"; samsung,pin-function = <0>; samsung,pin-pud = <1>; samsung,pin-drv = <0x0>; };
  gpa3-3 { samsung,pins = "gpa3-3"; samsung,pin-function = <0>; samsung,pin-pud = <1>; samsung,pin-drv = <0x0>; };
  gpa3-5 { samsung,pins = "gpa3-5"; samsung,pin-function = <0>; samsung,pin-pud = <1>; samsung,pin-drv = <0x0>; };
 };
};


&pinctrl_1 {
 pinctrl-names = "sleep";
 pinctrl-0 = <&sleep1>;
 sleep1: sleep-state {
  gpz0-0 { samsung,pins = "gpz0-0"; samsung,pin-con-pdn = <2>; samsung,pin-pud-pdn = <1>; };
  gpz0-1 { samsung,pins = "gpz0-1"; samsung,pin-con-pdn = <2>; samsung,pin-pud-pdn = <1>; };
  gpz0-2 { samsung,pins = "gpz0-2"; samsung,pin-con-pdn = <2>; samsung,pin-pud-pdn = <1>; };
  gpz0-3 { samsung,pins = "gpz0-3"; samsung,pin-con-pdn = <2>; samsung,pin-pud-pdn = <1>; };

  gpz1-0 { samsung,pins = "gpz1-0"; samsung,pin-con-pdn = <1>; samsung,pin-pud-pdn = <3>; };
  gpz1-1 { samsung,pins = "gpz1-1"; samsung,pin-con-pdn = <2>; samsung,pin-pud-pdn = <3>; };
  gpz1-2 { samsung,pins = "gpz1-2"; samsung,pin-con-pdn = <2>; samsung,pin-pud-pdn = <3>; };
  gpz1-3 { samsung,pins = "gpz1-3"; samsung,pin-con-pdn = <1>; samsung,pin-pud-pdn = <3>; };

  gpz2-0 { samsung,pins = "gpz2-0"; samsung,pin-con-pdn = <2>; samsung,pin-pud-pdn = <1>; };
  gpz2-1 { samsung,pins = "gpz2-1"; samsung,pin-con-pdn = <2>; samsung,pin-pud-pdn = <1>; };
  gpz2-2 { samsung,pins = "gpz2-2"; samsung,pin-con-pdn = <2>; samsung,pin-pud-pdn = <1>; };
  gpz2-3 { samsung,pins = "gpz2-3"; samsung,pin-con-pdn = <2>; samsung,pin-pud-pdn = <1>; };

  gpz3-0 { samsung,pins = "gpz3-0"; samsung,pin-con-pdn = <2>; samsung,pin-pud-pdn = <1>; };
  gpz3-1 { samsung,pins = "gpz3-1"; samsung,pin-con-pdn = <2>; samsung,pin-pud-pdn = <1>; };
  gpz3-2 { samsung,pins = "gpz3-2"; samsung,pin-con-pdn = <2>; samsung,pin-pud-pdn = <1>; };
  gpz3-3 { samsung,pins = "gpz3-3"; samsung,pin-con-pdn = <2>; samsung,pin-pud-pdn = <1>; };
 };
};


&pinctrl_2 {
 pinctrl-names = "sleep";
 pinctrl-0 = <&sleep2>;
 sleep2: sleep-state {
  gpc0-0 { samsung,pins = "gpc0-0"; samsung,pin-con-pdn = <2>; samsung,pin-pud-pdn = <1>; };
  gpc0-1 { samsung,pins = "gpc0-1"; samsung,pin-con-pdn = <2>; samsung,pin-pud-pdn = <1>; };
  gpc0-2 { samsung,pins = "gpc0-2"; samsung,pin-con-pdn = <2>; samsung,pin-pud-pdn = <1>; };
  gpc0-3 { samsung,pins = "gpc0-3"; samsung,pin-con-pdn = <2>; samsung,pin-pud-pdn = <1>; };
 };
};


&pinctrl_3 {
 pinctrl-names = "sleep";
 pinctrl-0 = <&sleep3>;
 sleep3: sleep-state {
  gpr4-2 { samsung,pins = "gpr4-2"; samsung,pin-con-pdn = <2>; samsung,pin-pud-pdn = <1>; };
 };
};


&pinctrl_4 {
 pinctrl-names = "sleep";
 pinctrl-0 = <&sleep4>;
 sleep4: sleep-state {
  gpm0-0 { samsung,pins = "gpm0-0"; samsung,pin-con-pdn = <2>; samsung,pin-pud-pdn = <0>; };
  gpm0-1 { samsung,pins = "gpm0-1"; samsung,pin-con-pdn = <2>; samsung,pin-pud-pdn = <0>; };
 };
};


&pinctrl_5 {
 pinctrl-names = "sleep";
 pinctrl-0 = <&sleep5>;
 sleep5: sleep-state {
  gpc3-0 { samsung,pins = "gpc3-0"; samsung,pin-con-pdn = <2>; samsung,pin-pud-pdn = <1>; };
  gpc3-1 { samsung,pins = "gpc3-1"; samsung,pin-con-pdn = <2>; samsung,pin-pud-pdn = <1>; };
  gpc3-2 { samsung,pins = "gpc3-2"; samsung,pin-con-pdn = <2>; samsung,pin-pud-pdn = <1>; };
  gpc3-3 { samsung,pins = "gpc3-3"; samsung,pin-con-pdn = <2>; samsung,pin-pud-pdn = <1>; };
 };
};


&pinctrl_6 {
 pinctrl-names = "default","sleep";
 pinctrl-0 = <&initial6>;
 pinctrl-1 = <&sleep6>;
 initial6: initial-state {
  gpb0-2 { samsung,pins = "gpb0-2"; samsung,pin-function = <0>; samsung,pin-pud = <1>; samsung,pin-drv = <0x0>; };
  gpb0-3 { samsung,pins = "gpb0-3"; samsung,pin-function = <0>; samsung,pin-pud = <1>; samsung,pin-drv = <0x0>; };

  gpb2-4 { samsung,pins = "gpb2-4"; samsung,pin-function = <0>; samsung,pin-pud = <1>; samsung,pin-drv = <0x0>; };
  gpb2-6 { samsung,pins = "gpb2-6"; samsung,pin-function = <0>; samsung,pin-pud = <1>; samsung,pin-drv = <0x0>; };
  gpb2-7 { samsung,pins = "gpb2-7"; samsung,pin-function = <0>; samsung,pin-pud = <1>; samsung,pin-drv = <0x0>; };

  gpd0-0 { samsung,pins = "gpd0-0"; samsung,pin-function = <0>; samsung,pin-pud = <0>; samsung,pin-drv = <0x0>; };
  gpd0-1 { samsung,pins = "gpd0-1"; samsung,pin-function = <0>; samsung,pin-pud = <0>; samsung,pin-drv = <0x0>; };
  gpd0-2 { samsung,pins = "gpd0-2"; samsung,pin-function = <0>; samsung,pin-pud = <0>; samsung,pin-drv = <0x0>; };
  gpd0-3 { samsung,pins = "gpd0-3"; samsung,pin-function = <0>; samsung,pin-pud = <0>; samsung,pin-drv = <0x0>; };

  gpd0-5 { samsung,pins = "gpd0-5"; samsung,pin-function = <1>; samsung,pin-pud = <0>; samsung,pin-drv = <0x0>; samsung,pin-val = <0>; };
  gpd0-6 { samsung,pins = "gpd0-6"; samsung,pin-function = <1>; samsung,pin-pud = <0>; samsung,pin-drv = <0x0>; samsung,pin-val = <0>; };

  gpd2-2 { samsung,pins = "gpd2-2"; samsung,pin-function = <1>; samsung,pin-pud = <0>; samsung,pin-drv = <0x0>; samsung,pin-val = <1>; };

  gpd3-3 { samsung,pins = "gpd3-3"; samsung,pin-function = <0>; samsung,pin-pud = <3>; samsung,pin-drv = <0x0>; };
  gpd3-4 { samsung,pins = "gpd3-4"; samsung,pin-function = <0>; samsung,pin-pud = <3>; samsung,pin-drv = <0x0>; };

  gpf0-4 { samsung,pins = "gpf0-4"; samsung,pin-function = <0>; samsung,pin-pud = <1>; samsung,pin-drv = <0x0>; };

  gpf2-0 { samsung,pins = "gpf2-0"; samsung,pin-function = <0>; samsung,pin-pud = <1>; samsung,pin-drv = <0x0>; };
  gpf2-1 { samsung,pins = "gpf2-1"; samsung,pin-function = <0>; samsung,pin-pud = <1>; samsung,pin-drv = <0x0>; };
 };
 sleep6: sleep-state {
  gpb0-0 { samsung,pins = "gpb0-0"; samsung,pin-con-pdn = <2>; samsung,pin-pud-pdn = <1>; };
  gpb0-1 { samsung,pins = "gpb0-1"; samsung,pin-con-pdn = <2>; samsung,pin-pud-pdn = <1>; };
  gpb0-2 { samsung,pins = "gpb0-2"; samsung,pin-con-pdn = <2>; samsung,pin-pud-pdn = <1>; };
  gpb0-3 { samsung,pins = "gpb0-3"; samsung,pin-con-pdn = <2>; samsung,pin-pud-pdn = <1>; };

  gpb0-4 { samsung,pins = "gpb0-4"; samsung,pin-con-pdn = <2>; samsung,pin-pud-pdn = <3>; };
  gpb0-5 { samsung,pins = "gpb0-5"; samsung,pin-con-pdn = <1>; samsung,pin-pud-pdn = <3>; };
  gpb0-6 { samsung,pins = "gpb0-6"; samsung,pin-con-pdn = <2>; samsung,pin-pud-pdn = <1>; };
  gpb0-7 { samsung,pins = "gpb0-7"; samsung,pin-con-pdn = <0>; samsung,pin-pud-pdn = <1>; };


  gpb1-0 { samsung,pins = "gpb1-0"; samsung,pin-con-pdn = <2>; samsung,pin-pud-pdn = <1>; };
  gpb1-1 { samsung,pins = "gpb1-1"; samsung,pin-con-pdn = <2>; samsung,pin-pud-pdn = <1>; };

  gpb2-0 { samsung,pins = "gpb2-0"; samsung,pin-con-pdn = <2>; samsung,pin-pud-pdn = <1>; };
  gpb2-1 { samsung,pins = "gpb2-1"; samsung,pin-con-pdn = <2>; samsung,pin-pud-pdn = <1>; };
  gpb2-2 { samsung,pins = "gpb2-2"; samsung,pin-con-pdn = <2>; samsung,pin-pud-pdn = <1>; };
  gpb2-3 { samsung,pins = "gpb2-3"; samsung,pin-con-pdn = <2>; samsung,pin-pud-pdn = <1>; };
  gpb2-4 { samsung,pins = "gpb2-4"; samsung,pin-con-pdn = <2>; samsung,pin-pud-pdn = <1>; };
  gpb2-5 { samsung,pins = "gpb2-5"; samsung,pin-con-pdn = <2>; samsung,pin-pud-pdn = <1>; };
  gpb2-6 { samsung,pins = "gpb2-6"; samsung,pin-con-pdn = <2>; samsung,pin-pud-pdn = <1>; };
  gpb2-7 { samsung,pins = "gpb2-7"; samsung,pin-con-pdn = <2>; samsung,pin-pud-pdn = <1>; };

  gpc1-0 { samsung,pins = "gpc1-0"; samsung,pin-con-pdn = <1>; samsung,pin-pud-pdn = <0>; };
  gpc1-1 { samsung,pins = "gpc1-1"; samsung,pin-con-pdn = <2>; samsung,pin-pud-pdn = <1>; };
  gpc1-2 { samsung,pins = "gpc1-2"; samsung,pin-con-pdn = <2>; samsung,pin-pud-pdn = <1>; };
  gpc1-3 { samsung,pins = "gpc1-3"; samsung,pin-con-pdn = <2>; samsung,pin-pud-pdn = <1>; };
  gpc1-4 { samsung,pins = "gpc1-4"; samsung,pin-con-pdn = <2>; samsung,pin-pud-pdn = <1>; };

  gpc2-0 { samsung,pins = "gpc2-0"; samsung,pin-con-pdn = <2>; samsung,pin-pud-pdn = <0>; };
  gpc2-1 { samsung,pins = "gpc2-1"; samsung,pin-con-pdn = <2>; samsung,pin-pud-pdn = <0>; };
  gpc2-2 { samsung,pins = "gpc2-2"; samsung,pin-con-pdn = <2>; samsung,pin-pud-pdn = <0>; };
  gpc2-3 { samsung,pins = "gpc2-3"; samsung,pin-con-pdn = <2>; samsung,pin-pud-pdn = <0>; };
  gpc2-4 { samsung,pins = "gpc2-4"; samsung,pin-con-pdn = <2>; samsung,pin-pud-pdn = <0>; };
  gpc2-5 { samsung,pins = "gpc2-5"; samsung,pin-con-pdn = <2>; samsung,pin-pud-pdn = <0>; };

  gpc5-0 { samsung,pins = "gpc5-0"; samsung,pin-con-pdn = <2>; samsung,pin-pud-pdn = <1>; };
  gpc5-1 { samsung,pins = "gpc5-1"; samsung,pin-con-pdn = <2>; samsung,pin-pud-pdn = <1>; };
  gpc5-2 { samsung,pins = "gpc5-2"; samsung,pin-con-pdn = <2>; samsung,pin-pud-pdn = <1>; };
  gpc5-3 { samsung,pins = "gpc5-3"; samsung,pin-con-pdn = <2>; samsung,pin-pud-pdn = <1>; };

  gpd0-0 { samsung,pins = "gpd0-0"; samsung,pin-con-pdn = <2>; samsung,pin-pud-pdn = <0>; };
  gpd0-1 { samsung,pins = "gpd0-1"; samsung,pin-con-pdn = <2>; samsung,pin-pud-pdn = <0>; };
  gpd0-2 { samsung,pins = "gpd0-2"; samsung,pin-con-pdn = <2>; samsung,pin-pud-pdn = <0>; };
  gpd0-3 { samsung,pins = "gpd0-3"; samsung,pin-con-pdn = <2>; samsung,pin-pud-pdn = <0>; };
  gpd0-4 { samsung,pins = "gpd0-4"; samsung,pin-con-pdn = <3>; samsung,pin-pud-pdn = <0>; };
  gpd0-5 { samsung,pins = "gpd0-5"; samsung,pin-con-pdn = <0>; samsung,pin-pud-pdn = <1>; };
  gpd0-6 { samsung,pins = "gpd0-6"; samsung,pin-con-pdn = <2>; samsung,pin-pud-pdn = <1>; };
  gpd0-7 { samsung,pins = "gpd0-7"; samsung,pin-con-pdn = <2>; samsung,pin-pud-pdn = <1>; };

  gpd1-0 { samsung,pins = "gpd1-0"; samsung,pin-con-pdn = <3>; samsung,pin-pud-pdn = <0>; };
  gpd1-1 { samsung,pins = "gpd1-1"; samsung,pin-con-pdn = <2>; samsung,pin-pud-pdn = <1>; };
  gpd1-2 { samsung,pins = "gpd1-2"; samsung,pin-con-pdn = <2>; samsung,pin-pud-pdn = <1>; };
  gpd1-3 { samsung,pins = "gpd1-3"; samsung,pin-con-pdn = <0>; samsung,pin-pud-pdn = <1>; };
  gpd1-4 { samsung,pins = "gpd1-4"; samsung,pin-con-pdn = <2>; samsung,pin-pud-pdn = <1>; };
  gpd1-5 { samsung,pins = "gpd1-5"; samsung,pin-con-pdn = <2>; samsung,pin-pud-pdn = <0>; };
  gpd1-6 { samsung,pins = "gpd1-6"; samsung,pin-con-pdn = <2>; samsung,pin-pud-pdn = <0>; };

  gpd2-0 { samsung,pins = "gpd2-0"; samsung,pin-con-pdn = <2>; samsung,pin-pud-pdn = <0>; };
  gpd2-1 { samsung,pins = "gpd2-1"; samsung,pin-con-pdn = <2>; samsung,pin-pud-pdn = <0>; };
  gpd2-2 { samsung,pins = "gpd2-2"; samsung,pin-con-pdn = <3>; samsung,pin-pud-pdn = <0>; };
  gpd2-3 { samsung,pins = "gpd2-3"; samsung,pin-con-pdn = <2>; samsung,pin-pud-pdn = <1>; };
  gpd2-4 { samsung,pins = "gpd2-4"; samsung,pin-con-pdn = <2>; samsung,pin-pud-pdn = <1>; };
  gpd2-5 { samsung,pins = "gpd2-5"; samsung,pin-con-pdn = <2>; samsung,pin-pud-pdn = <1>; };
  gpd2-6 { samsung,pins = "gpd2-6"; samsung,pin-con-pdn = <0>; samsung,pin-pud-pdn = <1>; };
  gpd2-7 { samsung,pins = "gpd2-7"; samsung,pin-con-pdn = <2>; samsung,pin-pud-pdn = <1>; };

  gpd3-0 { samsung,pins = "gpd3-0"; samsung,pin-con-pdn = <2>; samsung,pin-pud-pdn = <1>; };
  gpd3-1 { samsung,pins = "gpd3-1"; samsung,pin-con-pdn = <3>; samsung,pin-pud-pdn = <0>; };
  gpd3-2 { samsung,pins = "gpd3-2"; samsung,pin-con-pdn = <2>; samsung,pin-pud-pdn = <1>; };
  gpd3-3 { samsung,pins = "gpd3-3"; samsung,pin-con-pdn = <2>; samsung,pin-pud-pdn = <0>; };
  gpd3-4 { samsung,pins = "gpd3-4"; samsung,pin-con-pdn = <2>; samsung,pin-pud-pdn = <0>; };

  gpe0-0 { samsung,pins = "gpe0-0"; samsung,pin-con-pdn = <2>; samsung,pin-pud-pdn = <1>; };
  gpe0-1 { samsung,pins = "gpe0-1"; samsung,pin-con-pdn = <3>; samsung,pin-pud-pdn = <0>; };
  gpe0-2 { samsung,pins = "gpe0-2"; samsung,pin-con-pdn = <2>; samsung,pin-pud-pdn = <1>; };
  gpe0-3 { samsung,pins = "gpe0-3"; samsung,pin-con-pdn = <2>; samsung,pin-pud-pdn = <1>; };
  gpe0-4 { samsung,pins = "gpe0-4"; samsung,pin-con-pdn = <2>; samsung,pin-pud-pdn = <1>; };
  gpe0-5 { samsung,pins = "gpe0-5"; samsung,pin-con-pdn = <2>; samsung,pin-pud-pdn = <1>; };
  gpe0-6 { samsung,pins = "gpe0-6"; samsung,pin-con-pdn = <3>; samsung,pin-pud-pdn = <0>; };
  gpe0-7 { samsung,pins = "gpe0-7"; samsung,pin-con-pdn = <2>; samsung,pin-pud-pdn = <1>; };

  gpe1-0 { samsung,pins = "gpe1-0"; samsung,pin-con-pdn = <3>; samsung,pin-pud-pdn = <0>; };
  gpe1-1 { samsung,pins = "gpe1-1"; samsung,pin-con-pdn = <2>; samsung,pin-pud-pdn = <1>; };
  gpe1-2 { samsung,pins = "gpe1-2"; samsung,pin-con-pdn = <2>; samsung,pin-pud-pdn = <1>; };
  gpe1-3 { samsung,pins = "gpe1-3"; samsung,pin-con-pdn = <2>; samsung,pin-pud-pdn = <1>; };
  gpe1-4 { samsung,pins = "gpe1-4"; samsung,pin-con-pdn = <2>; samsung,pin-pud-pdn = <1>; };

  gpf0-0 { samsung,pins = "gpf0-0"; samsung,pin-con-pdn = <2>; samsung,pin-pud-pdn = <0>; };
  gpf0-1 { samsung,pins = "gpf0-1"; samsung,pin-con-pdn = <2>; samsung,pin-pud-pdn = <0>; };
  gpf0-2 { samsung,pins = "gpf0-2"; samsung,pin-con-pdn = <2>; samsung,pin-pud-pdn = <0>; };
  gpf0-3 { samsung,pins = "gpf0-3"; samsung,pin-con-pdn = <2>; samsung,pin-pud-pdn = <0>; };
  gpf0-4 { samsung,pins = "gpf0-4"; samsung,pin-con-pdn = <2>; samsung,pin-pud-pdn = <1>; };

  gpf1-0 { samsung,pins = "gpf1-0"; samsung,pin-con-pdn = <2>; samsung,pin-pud-pdn = <1>; };
  gpf1-1 { samsung,pins = "gpf1-1"; samsung,pin-con-pdn = <2>; samsung,pin-pud-pdn = <1>; };
  gpf1-2 { samsung,pins = "gpf1-2"; samsung,pin-con-pdn = <2>; samsung,pin-pud-pdn = <1>; };
  gpf1-3 { samsung,pins = "gpf1-3"; samsung,pin-con-pdn = <2>; samsung,pin-pud-pdn = <1>; };
  gpf1-4 { samsung,pins = "gpf1-4"; samsung,pin-con-pdn = <2>; samsung,pin-pud-pdn = <1>; };
  gpf1-5 { samsung,pins = "gpf1-5"; samsung,pin-con-pdn = <2>; samsung,pin-pud-pdn = <1>; };
  gpf1-6 { samsung,pins = "gpf1-6"; samsung,pin-con-pdn = <2>; samsung,pin-pud-pdn = <1>; };
  gpf1-7 { samsung,pins = "gpf1-7"; samsung,pin-con-pdn = <2>; samsung,pin-pud-pdn = <1>; };

  gpf2-0 { samsung,pins = "gpf2-0"; samsung,pin-con-pdn = <2>; samsung,pin-pud-pdn = <1>; };
  gpf2-1 { samsung,pins = "gpf2-1"; samsung,pin-con-pdn = <2>; samsung,pin-pud-pdn = <1>; };
 };
};


&pinctrl_7 {
 pinctrl-names = "sleep";
 pinctrl-0= <&sleep7>;
 sleep7: sleep-state {
  gpc4-0 { samsung,pins = "gpc4-0"; samsung,pin-con-pdn = <2>; samsung,pin-pud-pdn = <0>; };
  gpc4-1 { samsung,pins = "gpc4-1"; samsung,pin-con-pdn = <2>; samsung,pin-pud-pdn = <0>; };
  gpc4-2 { samsung,pins = "gpc4-2"; samsung,pin-con-pdn = <3>; samsung,pin-pud-pdn = <0>; };
 };
};
# 18 "arch/arm64/boot/dts/exynos7580-j7e3g_rev00.dts" 2

/ {
 model = "Samsung J7ELTE revision 00 board based on EXYNOS7580";
 model_info-chip = <7580>;
 model_info-platform = "android";
 model_info-subtype = "samsung";
 model_info-hw_rev = <0>;
 model_info-hw_rev_end = <4>;
 compatible = "samsung,exynos7580-universal7580,r01", "samsung,exynos7580";

 chosen {
  bootargs = "console=ttySAC1,115200n8 ess_setup=0x46000000 pmic_info=0x02";
  linux,initrd-start = <0x42000000>;
  linux,initrd-end = <0x421FFFFF>;
 };

 fixed-rate-clocks {
  oscclk {
   compatible = "samsung,exynos7580-oscclk";
   clock-frequency = <26000000>;
  };
 };

 dwmmc0@13540000 {
  status = "okay";
  num-slots = <1>;
  broken-cd;
  use-smu;
  fixed_volt;
  clock-gate;
  enable-cclk-on-suspend;
  only_once_tune;
  use-fine-tuning;
  ignore-phase = <(1 << 7)>;
  bypass-for-allpass;
  supports-highspeed;
  supports-hs200-mode;
  supports-ddr200-enhanced-strobe;
  supports-poweroff-notification;
  supports-ddr200-mode;
  enable-cache-control;
  use-enable-shift;
  enable-ulp-mode;
  desc-size = <4>;
  qos_int_level = <200000>;
  fifo-depth = <0x40>;
  card-detect-delay = <100>;
  data-timeout = <200>;
  samsung,dw-mshc-ciu-div = <3>;
  samsung,dw-mshc-sdr-timing = <3 0 2 0>;
  samsung,dw-mshc-ddr-timing = <3 0 2 2>;
  samsung,dw-mshc-hs200-timing = <3 0 3 0>;
  samsung,dw-mshc-ddr200-timing = <1 0 2 0>;
  samsung,dw-mshc-ddr200-ulp-timing = <3 0 3 0>;
  samsung,dw-mshc-ddr200-delay-line = <0x28>;
  samsung,dw-mshc-ddr200-tx-delay-line = <0x28>;
  samsung,dw-mshc-txdt-crc-timer-fastlimit = <0x34>;
  samsung,dw-mshc-txdt-crc-timer-initval = <0x38>;
  clk_pin = "gpr0-0";
  clk_addr = "13750000.pinctrl";
  clk_val = <0x2>;
  clk_str_num = <3>;
  num-ref-clks = <10>;
  ciu_clkin = <25 50 50 100 200 100 200 400 400 200>;
  pinctrl-names = "default";
  pinctrl-0 = <&sd0_clk &sd0_cmd &sd0_rdqs &sd0_bus1 &sd0_bus4 &sd0_bus8>;
  slot@0 {
   reg = <0>;
   bus-width = <8>;
  };
 };

 dwmmc1@13550000 {
  status = "okay";
  num-slots = <1>;
  channel = <1>;
  fixed_volt;
  clock-gate;
  enable-cclk-on-suspend;

  caps-control;
  supports-highspeed;
  keep-power-in-suspend;
  pm-ignore-notify;
  cd-type-external;
  use-broken-voltage;
  use-fine-tuning;
  ignore-phase = <(1 << 7)>;
  fifo-depth = <0x40>;
  card-detect-delay = <200>;
  qos_int_level = <468000>;
  samsung,dw-mshc-ciu-div = <3>;
  samsung,dw-mshc-sdr-timing = <3 0 2 1>;
  samsung,dw-mshc-ddr-timing = <3 0 2 1>;
  clk_pin = "gpr2-0";
  clk_addr = "13750000.pinctrl";
  clk_val = <0x2>;
  clk_str_num = <6>;
  num-ref-clks = <8>;
  ciu_clkin = <25 50 50 100 200 100 200 400>;
  tp_mon_depth = <2>;

                tp_mon_table = <8000000 825000 800000 0
    0 0 0 0>;
  pinctrl-names = "default";
  pinctrl-0 = <&sd1_clk &sd1_cmd &sd1_bus1 &sd1_bus4>;
  slot@0 {
   reg = <0>;
   bus-width = <4>;
  };
 };

 dwmmc2@13560000 {
  status = "okay";
  num-slots = <1>;
  supports-highspeed;
  enable-cclk-on-suspend;
  supports-sdr104-mode;
  bypass-smu;
  use-fine-tuning;
  clock-gate;
  fifo-depth = <0x40>;
  card-detect-delay = <200>;
  data-timeout = <200>;
  ignore-phase = <(1 << 7)>;
  bypass-for-allpass;
  desc-size = <4>;
  samsung,dw-mshc-ciu-div = <3>;
  samsung,dw-mshc-sdr-timing = <3 0 2 0>;
  samsung,dw-mshc-ddr-timing = <3 0 2 1>;
  clk_pin = "gpr4-0";
  clk_addr = "13750000.pinctrl";
  clk_val = <0x2>;
  clk_str_num = <3>;
  num-ref-clks = <8>;
  ciu_clkin = <25 50 50 100 200 100 200 400>;
  pinctrl-names = "default", "output";
  pinctrl-0 = <&sd2_clk &sd2_cmd &sd2_bus1 &sd2_bus4 &dwmmc2_cd_ext_irq>;
  pinctrl-1 = <&sd2_clk_output &sd2_cmd_output &sd2_bus1 &sd2_bus4 &dwmmc2_cd_ext_irq>;
  gpio-controller;
  sec-sd-slot-type = <1>;
  #gpio-cells = <2>;
  cd-gpio = <&gpa3 4 0xf>;
  slot@0 {
   reg = <0>;
   bus-width = <4>;
   disable-wp;
  };
 };

 gpio_keys{
  compatible = "gpio-keys";
  pinctrl-names = "default";
  pinctrl-0 = <&gpa2_pull_up_univ>;

  button@1 {
   label = "gpio-keys: KEY_POWER";
   interrupt-parent = <&gpa2>;
   linux,code = <116>;
   gpios = <&gpa2 7 0xf>;
   gpio-key,wakeup = <1>;
  };
  button@2 {
   label = "gpio-keys: KEY_VOLUMEDOWN";
   interrupt-parent = <&gpa2>;
   linux,code = <114>;
   gpios = <&gpa2 1 0xf>;
  };
  button@3 {
   label = "gpio-keys: KEY_VOLUMEUP";
   interrupt-parent = <&gpa2>;
   linux,code = <115>;
   gpios = <&gpa2 0 0xf>;
  };
  button@4 {
   label = "gpio-keys: KEY_HOMEPAGE";
   interrupt-parent = <&gpa2>;
   linux,code = <172>;
   gpios = <&gpa2 5 0xf>;
   gpio-key,wakeup = <1>;
  };
 };

 pinctrl@138D0000 {
  i2c_pdn_off: i2c-pdn_off {
   samsung,pins = "gpc4-1", "gpc4-0";
   samsung,pin-con-pdn = <2>;
   samsung,pin-pud-pdn = <1>;
  };
 };

 pinctrl@139B0000 {
  pmic_irq: pmic-irq {
   samsung,pins = "gpa0-2";
   samsung,pin-pud = <3>;
   samsung,pin-drv = <3>;
  };
  cfg_irq: cfg-irq {
   samsung,pins = "gpa0-3";
   samsung,pin-function = <0xf>;
   samsung,pin-pud = <3>;
   samsung,pin-drv = <0>;
  };
  cfg_input: cfg-input {
   samsung,pins = "gpa0-3";
   samsung,pin-function = <0>;
   samsung,pin-pud = <1>;
   samsung,pin-drv = <0>;
  };
  cod3022_irq: cod3022-irq {
   samsung,pins = "gpa0-4";
   samsung,pin-pud = <3>;
   samsung,pin-drv = <3>;
  };
  if_irq: if-irq {
   samsung,pins = "gpa0-5";
   samsung,pin-pud = <3>;
   samsung,pin-drv = <3>;
  };
  hall_irq: hall-irq {
   samsung,pins = "gpa3-6";
                 samsung,pin-function = <0xf>;
   samsung,pin-pud = <0>;
   samsung,pin-drv = <0>;
  };
  muic_irq: muic-irq {
   samsung,pins = "gpa1-3";
   samsung,pin-pud = <0>;
   samsung,pin-drv = <0>;
  };
  attn_input: attn-input {
   samsung,pins = "gpa3-2";
   samsung,pin-function = <0>;
   samsung,pin-pud = <1>;
   samsung,pin-drv = <0>;
  };
  attn_irq: attn-irq {
   samsung,pins = "gpa3-2";
   samsung,pin-function = <0xf>;
   samsung,pin-pud = <0>;
   samsung,pin-drv = <0>;
  };
  dwmmc2_cd_ext_irq: dwmmc2_cd_ext_irq {
   samsung,pins = "gpa3-4";
   samsung,pin-function = <0xf>;
   samsung,pin-pud = <3>;
   samsung,pin-drv = <0>;
  };
  earjack_jack_det: jack-det {
   samsung,pins = "gpa3-1";
   samsung,pin-function = <0xf>;
   samsung,pin-pud = <0>;
   samsung,pin-drv = <0>;
  };
  earjack_key_det: key-det {
   samsung,pins = "gpa3-0";
   samsung,pin-function = <0xf>;
   samsung,pin-pud = <0>;
   samsung,pin-drv = <0>;
  };
 };

 pinctrl@139C0000 {
  vibetonz_pwm: vibetonz_pwm {
   samsung,pins = "gpc1-1";
   samsung,pin-function = <2>;
   samsung,pin-pud = <0>;
   samsung,pin-drv = <0>;
  };
  cfg_i2c: cfg-i2c {
   samsung,pins = "gpc5-3", "gpc5-2";
   samsung,pin-function = <0>;
   samsung,pin-pud = <3>;
   samsung,pin-drv = <0>;
  };
  cfg_gpio: cfg-gpio {
   samsung,pins = "gpc5-3", "gpc5-2";
   samsung,pin-function = <0>;
   samsung,pin-pud = <0>;
   samsung,pin-drv = <0>;
  };
  motor_en: motor_en {
   samsung,pins = "gpe0-7";
   samsung,pin-function = <1>;
   samsung,pin-pud = <3>;
   samsung,pin-drv = <0>;
  };

  pm_wrsti: pm-wrsti {
   samsung,pins = "gpe1-0";
   samsung,pin-con-pdn = <3>;
  };
 };

 spi_1: spi@13920000 {
  /delete-property/ dma-mode;
  /delete-property/ dmas;
  /delete-property/ dma-names;
  #address-cells = <1>;
  #size-cells = <0>;
  pinctrl-names = "default";
  pinctrl-0 = <&spi1_bus>;
  pinctrl-1 = <&spi1_cs>;
  status = "okay";
 };

 i2c@13830000 {
  samsung,i2c-sda-delay = <100>;
  samsung,i2c-max-bus-freq = <400000>;
  status = "okay";
  #address-cells = <1>;
  #size-cells = <0>;

  s2801x: s2801x@7a {
   compatible = "samsung,s2801x";
   reg = <0x7a>;
   clocks = <&clock 154>,
     <&clock 155>,
     <&clock 156>,
     <&clock 157>,
     <&clock 152>,
     <&clock 149>;

   clock-names = "audmixer_sysclk", "audmixer_bclk0",
     "audmixer_bclk1", "audmixer_bclk2",
     "mi2s_bclk", "audmixer_dout";
   sysreg-reset = <0x110F2000>;
   sysreg-i2c = <0x110F3000>;
   pinctrl-names = "default", "idle";
   pinctrl-0 = <&i2s_pmic_bus
     &i2s_codec_clk
     &pcm_bt_bus>;
   pinctrl-1 = <&i2s_pmic_bus_idle
     &i2s_codec_clk_idle
     &pcm_bt_bus_idle>;
   samsung,lpass-subip;
  };
 };

 i2c@13860000 {
  samsung,i2c-sda-delay = <100>;
  samsung,i2c-max-bus-freq = <400000>;
  status = "okay";
  #address-cells = <1>;
  #size-cells = <0>;

  touchscreen@50 {
   compatible = "imagis,ist30xx-ts";
   reg = <0x50>;
   pinctrl-names = "on_state", "off_state";
   pinctrl-0 = <&attn_irq>;
   pinctrl-1 = <&attn_input &i2c_pdn_off>;
   imagis,regulator_avdd = "tsp_avdd";
   imagis,irq-gpio = <&gpa3 2 0>;
   imagis,fw-bin = <1>;
   imagis,ic-version = "ist3038c";
   imagis,project-name = "j7";
  };
 };

 i2c@20 {
  compatible = "i2c-gpio";
  gpios = <&gpc5 2 0
    &gpc5 3 0>;
  i2c-gpio,delay-us = <5>;
  pinctrl-names = "default","on_i2c","off_i2c";
  pinctrl-0 = <&cfg_i2c>;
  pinctrl-1 = <&cfg_i2c>;
  pinctrl-2 = <&cfg_gpio>;
  #address-cells = <1>;
  #size-cells = <0>;
  status = "okay";

  touchkey@20 {
   pinctrl-names = "on_irq","off_irq";
   pinctrl-0 = <&cfg_irq>;
   pinctrl-1 = <&cfg_input>;
   compatible = "coreriver,tc300-keypad";
   reg = <0x20>;
   interrupts = <2 0 0>;
   interrupt-parent = <&gpa0>;
   coreriver,scl-gpio = <&gpc5 3 0>;
   coreriver,sda-gpio = <&gpc5 2 0>;
   coreriver,irq-gpio = <&gpa0 3 0>;
   coreriver,regulator_ic = "vtouch_1.8v";
   coreriver,fw_name = "coreriver/tc305k_carmen2.fw";
   coreriver,sensing_ch_num = <0x4>;
   coreriver,tsk_ic_num = <0x1>;
   coreriver,use_bitmap = <1>;
  };
 };

 i2c@25 {
  compatible = "i2c-gpio";
  gpios = <&gpd3 4 0
   &gpd3 3 0>;
  i2c-gpio,delay-us = <5>;
  #address-cells = <1>;
  #size-cells = <0>;
  status = "okay";

  muic-universal@25 {
   status = "okay";
   compatible = "muic-universal";
   reg = <0x25>;
   pinctrl-names = "default";
   pinctrl-0 = <&muic_irq>;
   muic-universal,chip_name = "sm,sm5703";
   muic-universal,irq-gpio = <&gpa1 3 0>;
   muic-universal,uart-gpio = <&gpd2 2 0>;
   muic-universal,uart-ap = <0x1>;
  };
 };

 muic {
  status = "disabled";
  muic,support-list = "+OTG:GND",
     "-MHL:1K",
     "-VZW Accessory:28.7K",
     "-VZW Incompatible:34K",
     "-Smartdock:40.2K",
     "-HMT:49.9K",
     "-Audiodock:64.9K",
     "-USB LANHUB:80.07K",
     "+Charging Cable:102K",
     "-Universal Multimedia dock:121K",
     "+Jig USB Off:255K",
     "+Jig USB On:301K",
     "-Deskdock:365K",
     "+TYPE2 Charger:442K",
     "+Jig UART Off:523K",
     "+Jig UART On:619K",
     "+TA:OPEN",
     "+USB:OPEN",
     "+CDP:OPEN",
     "+Undefined Charging:XXX";
 };

 i2c@35 {
  compatible = "i2c-gpio";
  gpios = <&gpd1 6 0
   &gpd1 5 0>;
  i2c-gpio,delay-us = <5>;
  #address-cells = <1>;
  #size-cells = <0>;
  status = "okay";

  lm3632@35 {
   compatible = "lm3632,i2c";
   reg = <0x11>;
   pinctrl-names = "default";
   gpios = <&gpd3 0 0>;
  };
 };

 hsi2c@104c0000 {
  status = "okay";
  samsung,hs-mode;
  clock-frequency = <2500000>;
  samsung,hsi2c-batcher;
  #address-cells = <1>;
  #size-cells = <0>;

  audio_codec_cod3022x: cod3022x@04 {
   compatible = "codec,cod3022x";
   reg = <0x04>;
   ten-bit-address;
   vdd1-supply = <&ldo22_reg>;
   vdd2-supply = <&ldo23_reg>;
   pinctrl-names = "default";
   pinctrl-0 = <&cod3022_irq>;
   interrupt-parent = <&gpa0>;
   gpios = <&gpa0 4 0xf>;

   mic-bias1-voltage = <1>;
   mic-bias2-voltage = <1>;
  };

  s2mpu03_pmic@66 {
   compatible = "samsung,s2mpu03-pmic";
   reg = <0x66>;
   ten-bit-address;
   interrupts = <2 0 0>;
   interrupt-parent = <&gpa0>;
   pinctrl-names = "default";
   pinctrl-0 = <&pmic_irq &pm_wrsti>;
   g3d_en = <1>;





   wtsr_en = <1>;
   smpl_en = <1>;
   wtsr_timer_val = <3>;
   smpl_timer_val = <4>;
   check_jigon = <0>;

   init_time,sec = <0>;
   init_time,min = <0>;
   init_time,hour = <12>;
   init_time,mday = <1>;
   init_time,mon = <0>;
   init_time,year = <115>;
   init_time,wday = <4>;

   regulators {
    buck1_reg: BUCK1 {
     regulator-name = "cpu-cluster.1";
     regulator-min-microvolt = <600000>;
     regulator-max-microvolt = <1400000>;
     regulator-always-on;
     regulator-boot-on;
     regulator-ramp-delay = <12000>;
     regulator-initial-mode = <1>;
    };

    buck2_reg: BUCK2 {
     regulator-name = "cpu-cluster.0";
     regulator-min-microvolt = <600000>;
     regulator-max-microvolt = <1400000>;
     regulator-always-on;
     regulator-boot-on;
     regulator-ramp-delay = <12000>;
     regulator-initial-mode = <1>;
    };

    buck3_reg: BUCK3 {
     regulator-name = "vdd_intmif";
     regulator-min-microvolt = <600000>;
     regulator-max-microvolt = <1200000>;
     regulator-always-on;
     regulator-boot-on;
     regulator-ramp-delay = <12000>;
     regulator-initial-mode = <1>;
    };

    buck4_reg: BUCK4 {
     regulator-name = "vdd_g3d";
     regulator-min-microvolt = <600000>;
     regulator-max-microvolt = <1300000>;
     regulator-always-on;
     regulator-boot-on;
     regulator-ramp-delay = <12000>;
     regulator-initial-mode = <1>;
    };

    ldo1_reg: LDO1 {
     regulator-name = "vdd_ldo1";
     regulator-min-microvolt = <800000>;
     regulator-max-microvolt = <1200000>;
     regulator-always-on;
     regulator-ramp-delay = <12000>;
     regulator-initial-mode = <3>;
    };

    ldo2_reg: LDO2 {
     regulator-name = "vqmmc";
     regulator-min-microvolt = <1800000>;
     regulator-max-microvolt = <2800000>;
     regulator-boot-on;
     regulator-ramp-delay = <12000>;
     regulator-initial-mode = <1>;
    };

    ldo3_reg: LDO3 {
     regulator-name = "vdd_ldo3";
     regulator-min-microvolt = <1600000>;
     regulator-max-microvolt = <2000000>;
     regulator-boot-on;
     regulator-always-on;
     regulator-ramp-delay = <12000>;
     regulator-initial-mode = <3>;
    };

    ldo4_reg: LDO4 {
     regulator-name = "vdd_ldo4";
     regulator-min-microvolt = <1200000>;
     regulator-max-microvolt = <1200000>;
     regulator-boot-on;
     regulator-always-on;
     regulator-ramp-delay = <12000>;
     regulator-initial-mode = <1>;
    };

    ldo5_reg: LDO5 {
     regulator-name = "vdd_ldo5";
     regulator-min-microvolt = <1075000>;
     regulator-max-microvolt = <1350000>;
     regulator-boot-on;
     regulator-always-on;
     regulator-ramp-delay = <12000>;
     regulator-initial-mode = <3>;
    };

    ldo6_reg: LDO6 {
     regulator-name = "vdd_ldo6";
     regulator-min-microvolt = <900000>;
     regulator-max-microvolt = <1225000>;
     regulator-boot-on;
     regulator-always-on;
     regulator-ramp-delay = <12000>;
     regulator-initial-mode = <1>;
    };

    ldo7_reg: LDO7 {
     regulator-name = "vdd_ldo7";
     regulator-min-microvolt = <1600000>;
     regulator-max-microvolt = <2000000>;
     regulator-boot-on;
     regulator-always-on;
     regulator-initial-mode = <1>;
    };

    ldo8_reg: LDO8 {
     regulator-name = "vdd_ldo8";
     regulator-min-microvolt = <2250000>;
     regulator-max-microvolt = <3300000>;
     regulator-boot-on;
     regulator-always-on;
     regulator-initial-mode = <1>;
    };

    ldo10_reg: LDO10 {
     regulator-name = "vdd_ldo10";
     regulator-min-microvolt = <800000>;
     regulator-max-microvolt = <1350000>;
     regulator-always-on;
     regulator-initial-mode = <1>;
    };

    ldo22_reg: LDO22 {
     regulator-name = "codec_ldo22";
     regulator-min-microvolt = <1000000>;
     regulator-max-microvolt = <2375000>;
     regulator-initial-mode = <3>;
    };

    ldo23_reg: LDO23 {
     regulator-name = "codec_ldo23";
     regulator-min-microvolt = <1000000>;
     regulator-max-microvolt = <2375000>;
     regulator-initial-mode = <3>;
    };

    ldo24_reg: LDO24 {
     regulator-name = "vdd_ldo24";
        regulator-min-microvolt = <1800000>;
        regulator-max-microvolt = <3375000>;
        regulator-always-on;
        regulator-boot-on;
        regulator-initial-mode = <3>;
       };

    ldo25_reg: LDO25 {
        regulator-name = "vdd_ldo25";
        regulator-min-microvolt = <1000000>;
        regulator-max-microvolt = <2375000>;
        regulator-always-on;
        regulator-boot-on;
        regulator-initial-mode = <3>;
       };

    ldo26_reg: LDO26 {
     regulator-name = "vmmc";
     regulator-min-microvolt = <2800000>;
     regulator-max-microvolt = <2800000>;
     regulator-boot-on;
     regulator-initial-mode = <1>;
    };

    ldo27_reg: LDO27 {
     regulator-name = "VDDIO_1.8V_CAM";
     regulator-min-microvolt = <1800000>;
     regulator-max-microvolt = <1800000>;
     regulator-initial-mode = <0>;
    };

    ldo28_reg: LDO28 {
     regulator-name = "vtouch_1.8v";
     regulator-min-microvolt = <1800000>;
     regulator-max-microvolt = <1800000>;

     regulator-initial-mode = <1>;
    };

    ldo29_reg: LDO29 {
     regulator-name = "VDD_VTCAM_SENSOR_A2P8";
     regulator-min-microvolt = <2800000>;
     regulator-max-microvolt = <2800000>;
     regulator-initial-mode = <0>;
    };

    ldo30_reg: LDO30 {
     regulator-name = "LCD_3P0";
     regulator-min-microvolt = <3000000>;
     regulator-max-microvolt = <3000000>;
     regulator-boot-on;
     regulator-initial-mode = <3>;
    };

    ldo31_reg: LDO31 {
     regulator-name = "LCD_1P8";
     regulator-min-microvolt = <1800000>;
     regulator-max-microvolt = <1800000>;
     regulator-boot-on;
     regulator-initial-mode = <3>;
    };

    ldo32_reg: LDO32 {
     regulator-name = "VDDIO_1.8V_VT";
     regulator-min-microvolt = <1800000>;
     regulator-max-microvolt = <1800000>;
     regulator-initial-mode = <0>;
    };

    ldo33_reg: LDO33 {
     regulator-name = "tsp_avdd";
     regulator-min-microvolt = <3000000>;
     regulator-max-microvolt = <3000000>;
     regulator-initial-mode = <1>;
    };

    ldo34_reg: LDO34 {
     regulator-name = "VDD_SENSOR_2P85";
     regulator-min-microvolt = <2850000>;
     regulator-max-microvolt = <2850000>;
     regulator-initial-mode = <0>;
    };

    ldo35_reg: LDO35 {
     regulator-name = "VDD_CAM_SENSOR_A2P95";
     regulator-min-microvolt = <2950000>;
     regulator-max-microvolt = <2950000>;
     regulator-initial-mode = <0>;
    };

    ldo36_reg: LDO36 {
     regulator-name = "VDD_CAM_1P2";
     regulator-min-microvolt = <1200000>;
     regulator-max-microvolt = <1200000>;
     regulator-initial-mode = <0>;
    };

    ldo37_reg: LDO37 {
     regulator-name = "VDD_MOTOR";
     regulator-min-microvolt = <3300000>;
     regulator-max-microvolt = <3300000>;
    };

    ldo38_reg: LDO38 {
     regulator-name = "ldo38";
     regulator-min-microvolt = <2800000>;
     regulator-max-microvolt = <2800000>;
     regulator-always-on;
     regulator-initial-mode = <1>;
    };

    ldo39_reg: LDO39 {
     regulator-name = "ldo39";
     regulator-min-microvolt = <1800000>;
     regulator-max-microvolt = <1800000>;
     regulator-always-on;
     regulator-initial-mode = <3>;
    };
   };
  };
 };

 hsi2c@13880000 {
  status = "okay";
  fimc_is_eeprom_i2c@58 {
   compatible = "samsung,rear-eeprom-i2c";
   reg = <0x58>;
   fimc_is_rear_eeprom_pinname = "139C0000.pinctrl";
   fimc_is_rear_eeprom_sda = "gpc2-2";
   fimc_is_rear_eeprom_scl = "gpc2-3";
  };
 };

 i2c@10 {
  compatible = "i2c-gpio";
  gpios = <&gpf0 2 0x0
   &gpf0 3 0x0
   >;
  i2c-gpio,delay-us = <2>;
  status = "okay";
  clock-frequency = <400000>;

  fimc_is_eeprom_i2c@10 {
   compatible = "samsung,front-eeprom-i2c";
   reg = <0x10>;
   use_i2c_pinctrl;
   fimc_is_front_eeprom_pinname = "139c0000.pinctrl";
   fimc_is_front_eeprom_sda = "gpf0-2";
   fimc_is_front_eeprom_scl = "gpf0-3";
   pinfunc_on = <0>;
   pinfunc_off = <2>;
  };
 };

 fimc_is_sensor_3l2: fimc-is_sensor_3l2@0 {
  compatible = "samsung,exynos5-fimc-is-sensor-3l2";

  pinctrl-names = "pin0", "pin1";
  pinctrl-0 = <&fimc_is_mclk0_fn &fimc_is_i2c0>;
  pinctrl-1 = <&fimc_is_mclk0_in &fimc_is_i2c0>;

  position = <0>;
  id = <0>;
  mclk_ch = <0>;
  sensor_i2c_ch = <0>;
  sensor_i2c_addr = <0x5A>;

  gpio_reset = <&gpe0 4 0x1>;
  status = "okay";

  af {
   product_name = <13>;
   i2c_addr = <0x18>;
   i2c_ch = <0>;
  };

  flash {
   product_name = <11>;
   flash_first_gpio = <2>;
   flash_second_gpio = <1>;
  };
 };

 fimc_is_sensor_5e3: fimc-is_sensor_5e3@0 {
  compatible = "samsung,exynos5-fimc-is-sensor-5e3";

  pinctrl-names = "pin0", "pin1";
  pinctrl-0 = <&fimc_is_mclk1_fn &fimc_is_i2c1>;
  pinctrl-1 = <&fimc_is_mclk1_in &fimc_is_i2c1>;

  position = <1>;
  id = <1>;
  mclk_ch = <1>;
  sensor_i2c_ch = <1>;
  sensor_i2c_addr = <0x20>;

  gpio_reset = <&gpe0 3 0x1>;
  gpios_cam_en = <&gpd0 6 0x1>;
  status = "okay";

  flash {
   product_name = <5>;
   flash_first_gpio = <5>;
   flash_second_gpio = <5>;
  };
 };


 fimc_is_sensor0: fimc_is_sensor@144a0000 {
  scenario = <0>;
  id = <0>;
  mclk_ch = <0>;
  csi_ch = <0>;
  flite_ch = <0>;
  i2c_ch = <0>;
  i2c_addr = <0x0>;
  is_bns = <1>;
  status = "okay";
 };

 fimc_is_sensor1: fimc_is_sensor@144b0000 {
  scenario = <0>;
  id = <1>;
  mclk_ch = <1>;
  csi_ch = <1>;
  flite_ch = <1>;
  i2c_ch = <1>;
  i2c_addr = <0x0>;
  is_bns = <0>;
  status = "okay";
 };

 fimc_is@14400000 {
  rear_sensor_id = <8>;
  front_sensor_id = <17>;
  use_module_check;

  total_camera_num = <2>;
  camera_info0 {
   isp = <0>;
   cal_memory = <2>;
   read_version = <0>;
   core_voltage = <0>;
   upgrade = <0>;
   companion = <0>;
   ois = <0>;
  };
  camera_info1 {
   isp = <0>;
   cal_memory = <2>;
   read_version = <0>;
   core_voltage = <0>;
   upgrade = <0>;
   companion = <0>;
   ois = <0>;
  };
# 947 "arch/arm64/boot/dts/exynos7580-j7e3g_rev00.dts"
  fimc_is_dvfs {
   default_int = <400000>;
   default_cam = <530000>;
   default_mif = <825000>;
   default_i2c = <0>;

   front_preview_int = <200000>;
   front_preview_cam = <267000>;
   front_preview_mif = <559000>;
   front_preview_i2c = <0>;

   front_capture_int = <200000>;
   front_capture_cam = <267000>;
   front_capture_mif = <559000>;
   front_capture_i2c = <0>;

   front_video_int = <200000>;
   front_video_cam = <267000>;
   front_video_mif = <559000>;
   front_video_i2c = <0>;

   front_video_whd_int = <200000>;
   front_video_whd_cam = <267000>;
   front_video_whd_mif = <559000>;
   front_video_whd_i2c = <0>;

   front_video_capture_int = <200000>;
   front_video_capture_cam = <267000>;
   front_video_capture_mif = <559000>;
   front_video_capture_i2c = <0>;

   front_video_whd_capture_int = <400000>;
   front_video_whd_capture_cam = <530000>;
   front_video_whd_capture_mif = <825000>;
   front_video_whd_capture_i2c = <0>;

   front_vt1_int = <200000>;
   front_vt1_cam = <267000>;
   front_vt1_mif = <559000>;
   front_vt1_i2c = <0>;

   front_vt2_int = <200000>;
   front_vt2_cam = <267000>;
   front_vt2_mif = <559000>;
   front_vt2_i2c = <0>;

   rear_preview_fhd_int = <200000>;
   rear_preview_fhd_cam = <400000>;
   rear_preview_fhd_mif = <667000>;
   rear_preview_fhd_i2c = <0>;

   rear_preview_whd_int = <400000>;
   rear_preview_whd_cam = <530000>;
   rear_preview_whd_mif = <825000>;
   rear_preview_whd_i2c = <0>;

   rear_preview_uhd_int = <400000>;
   rear_preview_uhd_cam = <530000>;
   rear_preview_uhd_mif = <825000>;
   rear_preview_uhd_i2c = <0>;

   rear_capture_int = <200000>;
   rear_capture_cam = <400000>;
   rear_capture_mif = <667000>;
   rear_capture_i2c = <0>;

   rear_video_fhd_int = <200000>;
   rear_video_fhd_cam = <400000>;
   rear_video_fhd_mif = <667000>;
   rear_video_fhd_i2c = <0>;

   rear_video_uhd_int = <400000>;
   rear_video_uhd_cam = <530000>;
   rear_video_uhd_mif = <825000>;
   rear_video_uhd_i2c = <0>;

   rear_video_fhd_capture_int = <200000>;
   rear_video_fhd_capture_cam = <400000>;
   rear_video_fhd_capture_mif = <667000>;
   rear_video_fhd_capture_i2c = <0>;

   rear_video_uhd_capture_int = <400000>;
   rear_video_uhd_capture_cam = <530000>;
   rear_video_uhd_capture_mif = <825000>;
   rear_video_uhd_capture_i2c = <0>;

   dual_preview_int = <400000>;
   dual_preview_cam = <530000>;
   dual_preview_mif = <825000>;
   dual_preview_i2c = <0>;

   dual_capture_int = <400000>;
   dual_capture_cam = <530000>;
   dual_capture_mif = <825000>;
   dual_capture_i2c = <0>;

   dual_video_int = <400000>;
   dual_video_cam = <530000>;
   dual_video_mif = <825000>;
   dual_video_i2c = <0>;

   dual_video_capture_int = <400000>;
   dual_video_capture_cam = <530000>;
   dual_video_capture_mif = <825000>;
   dual_video_capture_i2c = <0>;

   preview_high_speed_fps_int = <400000>;
   preview_high_speed_fps_cam = <530000>;
   preview_high_speed_fps_mif = <825000>;
   preview_high_speed_fps_i2c = <0>;

   video_high_speed_fps_int = <400000>;
   video_high_speed_fps_cam = <530000>;
   video_high_speed_fps_mif = <825000>;
   video_high_speed_fps_i2c = <0>;

   max_int = <400000>;
   max_cam = <530000>;
   max_mif = <825000>;
   max_i2c = <0>;
  };
 };

 leds_ktd2692 {
  compatible = "ktd2692";
  flash_control = <&gpe0 5 0x1>;
  status = "okay";
  pinctrl-names ="default","host","is";
  pinctrl-0 = <&fled_flash_front_sleep>;
  pinctrl-1 = <&fled_flash_front_active>;
  pinctrl-2 = <&fled_flash_front_sleep>;
 };

 pinctrl@139C0000 {
  hs_i2c1_bus: hs-i2c1-bus {
   samsung,pins = "gpc2-3", "gpc2-2";
   samsung,pin-function = <2>;
   samsung,pin-pud = <0>;
   samsung,pin-drv = <0>;
  };
  fled_flash_sleep: fled-flash-sleep {
   samsung,pins = "gpe0-2", "gpe0-1";
   samsung,pin-function = <2>;
   samsung,pin-pud = <1>;
   samsung,pin-drv = <0>;
  };
  fled_flash_active: fled-flash-active {
   samsung,pins = "gpe0-2", "gpe0-1";
   samsung,pin-function = <1>;
   samsung,pin-pud = <1>;
   samsung,pin-drv = <0>;
  };
  fled_flash_front_sleep: fled-flash-front-sleep {
   samsung,pins = "gpe0-5";
   samsung,pin-function = <2>;
   samsung,pin-pud = <1>;
   samsung,pin-drv = <0>;
  };
  fled_flash_front_active: fled-flash-front-active {
   samsung,pins = "gpe0-5";
   samsung,pin-function = <1>;
   samsung,pin-pud = <0>;
   samsung,pin-drv = <0>;
  };
 };

 ion {
  compatible = "samsung,exynos5430-ion";
 };

 decon_fb@14830000 {

  gpios = <&gpd0 7 0xf>;
  psr_mode = <0>;
  trig_mode = <1>;
  disp-pll-clk = <63000000>;
  status = "okay";
 };

 dsim_0: dsim@14800000 {
  lcd_info = <&s6d7aa0>;

  gpios = <&gpd1 3 0x1>, <&gpf1 2 0x1>, <&gpf1 3 0x1>;
  lcd_vdd = "LCD_1P8";
  status = "okay";
 };

 s6d7aa0: s6d7aa0_wxga {
  mode = <0>;
  resolution = <720 1280>;
  size = <68 121>;
  timing,refresh = <60>;

  timing,h-porch = <58 16 10>;

  timing,v-porch = <12 16 4>;
  timing,dsi-hs-clk = <416>;
  timing,dsi-escape-clk = <16>;
  mic = <0>;
 };

 det_zones: det_zones {
  #list-det-cells = <4>;
 };

 but_zones: but_zones {
  #list-but-cells = <3>;
 };

 earjack {
  compatible = "sec_jack";
  detect-gpio = <&gpa3 1 0>;

  key-gpio = <&gpa3 0 0>;


  det-dbtime = <50>;

  det-zones-list = <&det_zones 3 10000 10 0>,
   <&det_zones 950 10000 10 2>,
   <&det_zones 2400 10000 10 1>,
   <&det_zones 9999 10000 10 1>;
  but-zones-list = <&but_zones 226 1 762>,
   <&but_zones 582 763 763>,
   <&but_zones 115 764 910>,
   <&but_zones 114 911 1700>;
  pinctrl-names = "default";
  pinctrl-0 = <&earjack_jack_det &earjack_key_det>;
  status = "okay";
 };

 i2s0: i2s@11040000 {
  status = "okay";
 };

 audio_cp_dummy: cp_dummy {
  compatible = "samsung,cp_dummy";
  status = "okay";
 };

 audio_bt_dummy: bt_dummy {
  compatible = "samsung,bt_dummy";
  status = "okay";
 };

 audio_fm_dummy: fm_dummy {
  compatible = "samsung,fm_dummy";
  status = "okay";
 };

 audio_codec_dummy: dummy-codec {
  compatible = "samsung,dummy-codec";
  status = "okay";
 };

 sound {
  compatible = "samsung,universal7580-cod3022x";
  samsung,audio-cpu = <&i2s0
     &i2s0
     &audio_cp_dummy
     &audio_bt_dummy
     &audio_fm_dummy
     &eax
     &eax>;
  samsung,audio-codec = <&audio_codec_cod3022x
     &audio_codec_cod3022x
     &audio_codec_cod3022x
     &audio_codec_dummy
     &audio_codec_cod3022x
     &audio_codec_cod3022x
     &audio_codec_cod3022x>;
  samsung,auxdev = <&s2801x>;
  samsung,use-externel-jd;
  clocks = <&clock 151>;
  clock-names = "codec_bclk";
  mic-bias-mode = <1 2 0>;
  pinctrl-names = "default";
  io-channels = <&exynos_adc 2>;
  io-channel-names = "adc-jack";
  #io-channel-cells = <1>;
  io-channel-ranges;

  status = "okay";
 };

 usb_notifier {
  compatible = "samsung,usb-notifier";
 };

 pinctrl@139B0000 {
   proximity_int: proximity-int {
   samsung,pins = "gpa1-4";
   samsung,pin-function = <0>;
   samsung,pin-pud = <3>;
  };
 };

 hsi2c@13870000 {
  pinctrl-names = "default";
  pinctrl-0 = <&sensor_i2c>;
  status = "okay";
  #address-cells = <1>;
  #size-cells = <0>;
  k2hh@1D {
   compatible = "stm,k2hh";
   reg = <0x1D>;
   interrupt-parent = <&gpa1>;
   interrupts = <0 0 0>;
   stm,irq_gpio = <&gpa1 0 0>;
   stm,axis_map_x = <1>;
   stm,axis_map_y = <0>;
   stm,axis_map_z = <2>;
   stm,negate_x = <0>;
   stm,negate_y = <1>;
   stm,negate_z = <1>;
   stm,poll_interval = <100>;
   stm,min_interval = <2>;
  };
  cm36672p@60 {
   compatible = "cm36672p";
   reg = <0x60>;
   pinctrl-names = "default";
   pinctrl-0 = <&proximity_int>;
   interrupt-parent = <&gpa1>;
   interrupts = <4 0 0>;
   cm36672p,irq_gpio = <&gpa1 4 0>;
   cm36672p,vdd-supply = <&sm5703_ldo2_reg>;
   cm36672p,vio-supply = <&ldo34_reg>;
   cm36672p,default_hi_thd = <17>;
   cm36672p,default_low_thd = <13>;
   cm36672p,cancel_hi_thd = <10>;
   cm36672p,cancel_low_thd = <7>;
   cm36672p,ps_it = <4>;
   cm36672p,led_current = <5>;
   cm36672p,default_trim = <0>;
  };
  stk3013@48 {
   compatible = "stk,stk3013";
   reg = <0x48>;
   interrupt-parent = <&gpa1>;
   interrupts = <4 0 0>;
   stk,vdd-supply = <&sm5703_ldo2_reg>;
   stk,vio-supply = <&ldo34_reg>;
   stk,irq-gpio = <&gpa1 4 0>;
   stk,state-reg = <0x2d>;
   stk,psctrl-reg = <0x71>;
   stk,alsctrl-reg = <0x2A>;
   stk,ledctrl-reg = <0xFF>;
   stk,wait-reg = <0x03>;
   stk,ps-thd-h = <50>;
   stk,ps-thd-l = <30>;
   stk,ps-default-offset = <0>;
   stk,transmittance = <500>;
  };
 };

 sec_vib {
  compatible = "sec_vib";
  sec_vib_pdata {
   status = "okay";
   sec_vib,max_timeout = <10000>;
   sec_vib,regulator = "VDD_MOTOR";
  };
 };

 serial_3: uart@11060000 {

  pinctrl-0 = <&uart_bt_active &uart_bt_output_sleep &uart_bt_input_sleep>;
  status = "okay";
 };

 bluetooth {
  compatible = "broadcom,bcm43xx";
  gpios = <&gpc4 2 0x1
    &gpa2 2 0x1
    &gpa2 6 0xF >;
  pinctrl-names = "default";
  pinctrl-0=<&bt_hostwake &bt_btwake &bt_en>;
  status = "okay";
 };

 input_booster {
  status = "okay";
  compatible = "input_booster";
  #address-cells = <1>;
  #size-cells = <0>;

  booster_key@1 {
   input_booster,label = "KEY";
   input_booster,type = <0>;

   input_booster,levels = <1>;



   input_booster,cpu_freqs = <1100000>;
   input_booster,hmp_boost = <0>;
   input_booster,kfc_freqs = <1100000>;
   input_booster,mif_freqs = <0>;
   input_booster,int_freqs = <0>;


   input_booster,head_times = <500>;
   input_booster,tail_times = <500>;
   input_booster,phase_times = <0>;
  };
  booster_key@2 {
   input_booster,label = "TOUCHKEY";
   input_booster,type = <1>;

   input_booster,levels = <1>;



   input_booster,cpu_freqs = <1100000>;
   input_booster,hmp_boost = <0>;
   input_booster,kfc_freqs = <1100000>;
   input_booster,mif_freqs = <0>;
   input_booster,int_freqs = <0>;


   input_booster,head_times = <0>;
   input_booster,tail_times = <200>;
   input_booster,phase_times = <0>;
  };
  booster_key@3 {
   input_booster,label = "TOUCH";
   input_booster,type = <2>;

   input_booster,levels = <1 2 3>;



   input_booster,cpu_freqs = <1100000 1100000 900000>;
   input_booster,hmp_boost = <0 0 0>;
   input_booster,kfc_freqs = <1100000 1100000 900000>;
   input_booster,mif_freqs = <0 0 0>;
   input_booster,int_freqs = <0 0 0>;


   input_booster,head_times = <200 200 0>;
   input_booster,tail_times = <300 300 0>;
   input_booster,phase_times = <0 0 0>;
  };
  booster_key@4 {
   input_booster,label = "MULTITOUCH";
   input_booster,type = <3>;

   input_booster,levels = <1 2>;



   input_booster,cpu_freqs = <1300000 800000>;
   input_booster,hmp_boost = <0 0>;
   input_booster,kfc_freqs = <1300000 800000>;
   input_booster,mif_freqs = <0 0>;
   input_booster,int_freqs = <0 0>;


   input_booster,head_times = <1000 1000>;
   input_booster,tail_times = <500 500>;
   input_booster,phase_times = <0 0>;
  };
  booster_key@5 {
   input_booster,label = "KEYBOARD";
   input_booster,type = <4>;

   input_booster,levels = <1 2>;



   input_booster,cpu_freqs = <1100000 1100000>;
   input_booster,hmp_boost = <0 0>;
   input_booster,kfc_freqs = <1100000 1100000>;
   input_booster,mif_freqs = <0 0>;
   input_booster,int_freqs = <0 0>;


   input_booster,head_times = <130 130>;
   input_booster,tail_times = <0 0>;
   input_booster,phase_times = <0 0>;
  };
  booster_key@6 {
   input_booster,label = "MOUSE";
   input_booster,type = <5>;

   input_booster,levels = <1 2>;



   input_booster,cpu_freqs = <1100000 900000>;
   input_booster,hmp_boost = <0 0>;
   input_booster,kfc_freqs = <1100000 900000>;
   input_booster,mif_freqs = <0 0>;
   input_booster,int_freqs = <0 0>;


   input_booster,head_times = <130 130>;
   input_booster,tail_times = <500 500>;
   input_booster,phase_times = <0 0>;
  };
  booster_key@7 {
   input_booster,label = "MOUSE WHEEL";
   input_booster,type = <6>;

   input_booster,levels = <1 2>;



   input_booster,cpu_freqs = <1100000 0>;
   input_booster,hmp_boost = <0 0>;
   input_booster,kfc_freqs = <1100000 0>;
   input_booster,mif_freqs = <0 0>;
   input_booster,int_freqs = <0 0>;


   input_booster,head_times = <130 0>;
   input_booster,tail_times = <0 0>;
   input_booster,phase_times = <0 0>;
  };

 };

 pinctrl@14CC0000 {
  uart0_rts: uart0-rts {
   samsung,pins = "gpb0-7";
   samsung,pin-function = <2>;
   samsung,pin-pud = <0>;
   samsung,pin-con-pdn = <1>;
   samsung,pin-pud-pdn = <0>;
  };

  uart0_cts: uart0-cts {
   samsung,pins = "gpb0-6";
   samsung,pin-function = <2>;
   samsung,pin-pud = <0>;
   samsung,pin-con-pdn = <2>;
   samsung,pin-pud-pdn = <1>;
  };

  uart0_tx: uart0-tx {
   samsung,pins = "gpb0-5";
   samsung,pin-function = <2>;
   samsung,pin-pud = <0>;
   samsung,pin-con-pdn = <2>;
   samsung,pin-pud-pdn = <3>;
  };

  uart0_rx: uart0-rx {
   samsung,pins = "gpb0-4";
   samsung,pin-function = <2>;
   samsung,pin-pud = <3>;
   samsung,pin-con-pdn = <2>;
   samsung,pin-pud-pdn = <3>;
  };
 };

 serial@14C10000 {
  pinctrl-0 = <&uart0_rts &uart0_cts &uart0_tx &uart0_rx>;
 };

 gps {
  compatible = "samsung,exynos-bcm4752";
  gpios = <&gpd2 6 0x1>;
  status = "okay";
 };

 hall {
  compatible = "hall";
  pinctrl-names = "default";
  pinctrl-0 = <&hall_irq>;
  hall,gpio_flip_cover = <&gpa3 6 0>;
  status = "okay";
 };

 argos {
  compatible = "samsung,argos";
  #address-cells = <1>;
# 1543 "arch/arm64/boot/dts/exynos7580-j7e3g_rev00.dts"
  boot_device@1 {
   net_boost,label="IPC";
   net_boost,node="rmnet0 rmnet1 rmnet2 rmnet3 rmnet4 rmnet5 rmnet6 rmnet7 umts_dm0";
   net_boost,table_size = <3>;
   net_boost,table= < 1 0 0 0 0 0 0 0 1
        20 0 0 800000 0 416000 100000 0 1
        50 0 0 1000000 0 825000 100000 0 1
       100 0 0 1400000 0 825000 100000 0 1>;
  };
# 1586 "arch/arm64/boot/dts/exynos7580-j7e3g_rev00.dts"
 };

 mif_pdata {
  pinctrl-names = "default";
  pinctrl-0 = <&cp_rst_n &ds_det>;


  gpios = <&gpd0 0 0x0>,
         <&gpd0 1 0x0>,
         <&gpd0 2 0x0>,
         <&gpd0 3 0x0>;

  modem_ctrl,gpio_cp_rst_n = <&gpe0 6 0x1>;
  mif,gpio_ds_det = <&gpd0 4 0x0>;

  mif,ap_clk_table = <

   1600000
   1500000
   1400000
   1300000
   1200000
   1100000
   1000000
   900000
   800000
   700000
   600000
   500000
   400000
   300000
   >;

  mif,mif_clk_table = <

   825000
   728000
   667000
   559000
   416000
   338000
   273000
   200000
   >;
 };

 pinctrl@139C0000 {
  ds_det: ds_det {
   samsung,pins = "gpd0-4";
   samsung,pin-function = <0>;
   samsung,pin-pud = <0>;
   samsung,pin-con-pdn = <3>;
   samsung,pin-pud-pdn = <0>;
  };

  cp_rst_n: cp_rst_n {
   samsung,pins = "gpe0-6";
   samsung,pin-function = <1>;
   samsung,pin-pud = <0>;
   samsung,pin-con-pdn = <1>;
   samsung,pin-pud-pdn = <0>;
  };

  sensor_i2c: sensor_i2c {
   samsung,pins = "gpc2-1", "gpc2-0";
   samsung,pin-function = <2>;
   samsung,pin-pud = <0>;
   samsung,pin-drv = <0>;
  };
 };
};
